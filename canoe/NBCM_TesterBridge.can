/*@!Encoding:65001*/
/*============================================================================
  NBCM_TesterBridge.can -- CANoe 12 bridge between the HTML tester and the
  restbus simulation in NBCM_Full_Restbus_Simulation.can

  GENERATED by tools/build_capl.py on 2026-11-21 12:11 UTC
  Do not edit by hand -- change the workbook and regenerate.

  HOW TO USE
  1) Add canoe/NBCM_Test.vsysvar to the CANoe configuration
     (System Variables window -> Import / add as file).
  2) Add this file to the SAME network node as the restbus simulation
     (or as an include in it) so it can see the CAPL variables.
  3) Measurement start: values flow restbus -> system variables.
  4) The HTML tester (or COM, or CAPL) sets NBCM_Test::DRIVE_MODE=1 to take
     control; then system variables -> restbus each 100 ms.

  SIGNAL CONTRACT
    NBCM_Test::<SignalName>      = value of that signal
    NBCM_Test::OFFLINE_<NODE>    = 1 -> node stops transmitting
    NBCM_Test::DRIVE_MODE        = 0 observe / 1 control
============================================================================*/

variables
{
  msTimer tmrTesterBridge;
  long  gLastDriveMode = 0;
  long  gTick = 0;

  // last time each node was heard on the bus, for the panel health LEDs.
  // 0 means nothing seen yet: the panel shows age 0 and a grey LED.
  dword gLastSeen_ABS;
  dword gLastSeen_DIAG;
  dword gLastSeen_EMS;
  dword gLastSeen_EPS;
  dword gLastSeen_HVAC;
  dword gLastSeen_ICN;
  dword gLastSeen_ICU;
  dword gLastSeen_ITPMS;
  dword gLastSeen_MMS;
  dword gLastSeen_PEPS;
  dword gLastSeen_RBG;
  dword gLastSeen_TCU;
  dword gLastSeen_TPMS;
}

/*----------------------------------------------------------------------------
  Heartbeat.  One receiver for every frame: any frame from a node refreshes
  its timestamp, so the panel LED goes green while the node talks and red
  once it is killed with OFFLINE_<NODE> -- a real timeout viewer.
----------------------------------------------------------------------------*/
on message *
{
  dword now = timeNow();

  if (this.ABS) gLastSeen_ABS = now;
  if (this.DIAG) gLastSeen_DIAG = now;
  if (this.EMS) gLastSeen_EMS = now;
  if (this.EPS) gLastSeen_EPS = now;
  if (this.HVAC) gLastSeen_HVAC = now;
  if (this.ICN) gLastSeen_ICN = now;
  if (this.ICU) gLastSeen_ICU = now;
  if (this.ITPMS) gLastSeen_ITPMS = now;
  if (this.MMS) gLastSeen_MMS = now;
  if (this.PEPS) gLastSeen_PEPS = now;
  if (this.RBG) gLastSeen_RBG = now;
  if (this.TCU) gLastSeen_TCU = now;
  if (this.TPMS) gLastSeen_TPMS = now;
}

on start
{
  setTimerCyclic(tmrTesterBridge, 100);
  write("[TesterBridge] active, namespace NBCM_Test");
}

/*----------------------------------------------------------------------------
  One tick: either publish restbus values to the system variables
  (DRIVE_MODE=0) or push tester values into the restbus (DRIVE_MODE=1).
----------------------------------------------------------------------------*/
on timer tmrTesterBridge
{
  long i;
  long driveMode = @sysvar::NBCM_Test::DRIVE_MODE;

  // node offline switches always come from the tester
  OFFLINE_ABS = @sysvar::NBCM_Test::OFFLINE_ABS;
  OFFLINE_DIAG = @sysvar::NBCM_Test::OFFLINE_DIAG;
  OFFLINE_EMS = @sysvar::NBCM_Test::OFFLINE_EMS;
  OFFLINE_EPS = @sysvar::NBCM_Test::OFFLINE_EPS;
  OFFLINE_HVAC = @sysvar::NBCM_Test::OFFLINE_HVAC;
  OFFLINE_ICN = @sysvar::NBCM_Test::OFFLINE_ICN;
  OFFLINE_ICU = @sysvar::NBCM_Test::OFFLINE_ICU;
  OFFLINE_ITPMS = @sysvar::NBCM_Test::OFFLINE_ITPMS;
  OFFLINE_MMS = @sysvar::NBCM_Test::OFFLINE_MMS;
  OFFLINE_PEPS = @sysvar::NBCM_Test::OFFLINE_PEPS;
  OFFLINE_RBG = @sysvar::NBCM_Test::OFFLINE_RBG;
  OFFLINE_TCU = @sysvar::NBCM_Test::OFFLINE_TCU;
  OFFLINE_TPMS = @sysvar::NBCM_Test::OFFLINE_TPMS;

  if (driveMode != gLastDriveMode)
  {
    write("[TesterBridge] DRIVE_MODE = %d", driveMode);
    gLastDriveMode = driveMode;
  }

  // scenario controls are always visible to both sides
  SCENARIO_RUNNING = @sysvar::NBCM_Test::SCENARIO_RUNNING;
  MANUAL_SPEED_MODE = @sysvar::NBCM_Test::MANUAL_SPEED_MODE;
  MANUAL_SPEED_KMH = @sysvar::NBCM_Test::MANUAL_SPEED_KMH;

  if (driveMode == 1)
  {
    // tester owns the signals
    Hs_Abs_Active = @sysvar::NBCM_Test::Hs_Abs_Active;
    Hs_Abs_DiagMode = @sysvar::NBCM_Test::Hs_Abs_DiagMode;
    Hs_Abs_Ebd_Active = @sysvar::NBCM_Test::Hs_Abs_Ebd_Active;
    Hs_Abs_Ebd_Error = @sysvar::NBCM_Test::Hs_Abs_Ebd_Error;
    Hs_Abs_Ebd_Warning = @sysvar::NBCM_Test::Hs_Abs_Ebd_Warning;
    Hs_Abs_Error = @sysvar::NBCM_Test::Hs_Abs_Error;
    Hs_Abs_Esp_Enable = @sysvar::NBCM_Test::Hs_Abs_Esp_Enable;
    Hs_Abs_Esp_Warning = @sysvar::NBCM_Test::Hs_Abs_Esp_Warning;
    Hs_Abs_Warning = @sysvar::NBCM_Test::Hs_Abs_Warning;
    Hs_Abs_Wheel_Speed_Fl = @sysvar::NBCM_Test::Hs_Abs_Wheel_Speed_Fl;
    Hs_Abs_Wheel_Speed_Fr = @sysvar::NBCM_Test::Hs_Abs_Wheel_Speed_Fr;
    Hs_Abs_Wheel_Speed_Rl = @sysvar::NBCM_Test::Hs_Abs_Wheel_Speed_Rl;
    Hs_Abs_Wheel_Speed_Rr = @sysvar::NBCM_Test::Hs_Abs_Wheel_Speed_Rr;
    Hs_Esc_GearShiftInhibit = @sysvar::NBCM_Test::Hs_Esc_GearShiftInhibit;
    Hs_Brake_Checksum = @sysvar::NBCM_Test::Hs_Brake_Checksum;
    Hs_Brake_RollCntr = @sysvar::NBCM_Test::Hs_Brake_RollCntr;
    Hs_Esc_EmergBrakeStatus = @sysvar::NBCM_Test::Hs_Esc_EmergBrakeStatus;
    Hs_Esc_EscDisableStatus = @sysvar::NBCM_Test::Hs_Esc_EscDisableStatus;
    Hs_Esc_EscError = @sysvar::NBCM_Test::Hs_Esc_EscError;
    Hs_Esc_HacActive = @sysvar::NBCM_Test::Hs_Esc_HacActive;
    Hs_Esc_HacError = @sysvar::NBCM_Test::Hs_Esc_HacError;
    Hs_Esc_LongAcceleration = @sysvar::NBCM_Test::Hs_Esc_LongAcceleration;
    Hs_Esc_LongAccelerationValid = @sysvar::NBCM_Test::Hs_Esc_LongAccelerationValid;
    Hs_Esc_TcsActive = @sysvar::NBCM_Test::Hs_Esc_TcsActive;
    Hs_Esc_TcsDisableStatus = @sysvar::NBCM_Test::Hs_Esc_TcsDisableStatus;
    Hs_Esc_TcsError = @sysvar::NBCM_Test::Hs_Esc_TcsError;
    Hs_Esc_TorqReductValid = @sysvar::NBCM_Test::Hs_Esc_TorqReductValid;
    Hs_Esc_TorqueReductType = @sysvar::NBCM_Test::Hs_Esc_TorqueReductType;
    Hs_Esc_TorqueReductValue = @sysvar::NBCM_Test::Hs_Esc_TorqueReductValue;
    Hs_Esp_Ctl = @sysvar::NBCM_Test::Hs_Esp_Ctl;
    Hs_AbsEsp_Sup_DiagMode = @sysvar::NBCM_Test::Hs_AbsEsp_Sup_DiagMode;
    Hs_Abs_Bus_Off_Counter = @sysvar::NBCM_Test::Hs_Abs_Bus_Off_Counter;
    Hs_Abs_Com_Loss = @sysvar::NBCM_Test::Hs_Abs_Com_Loss;
    Hs_Abs_Com_Loss_Counter = @sysvar::NBCM_Test::Hs_Abs_Com_Loss_Counter;
    Hs_Abs_Ecu_Dynamic_States = @sysvar::NBCM_Test::Hs_Abs_Ecu_Dynamic_States;
    Hs_Abs_Ecu_Static_States = @sysvar::NBCM_Test::Hs_Abs_Ecu_Static_States;
    Hs_Abs_Network_Management_State = @sysvar::NBCM_Test::Hs_Abs_Network_Management_State;
    Hs_Abs_Tx_TimeOut_Counter = @sysvar::NBCM_Test::Hs_Abs_Tx_TimeOut_Counter;
    Hs_Abs_VehicleSpeed = @sysvar::NBCM_Test::Hs_Abs_VehicleSpeed;
    Hs_Abs_VehicleSpeed_Invalid = @sysvar::NBCM_Test::Hs_Abs_VehicleSpeed_Invalid;
    Hs_Esc_Mcylinder_Pressure = @sysvar::NBCM_Test::Hs_Esc_Mcylinder_Pressure;
    Hs_Esc_Mcylinder_PressureInvalid = @sysvar::NBCM_Test::Hs_Esc_Mcylinder_PressureInvalid;
    Hs_Abs_Wheel_Pcnt_Fl = @sysvar::NBCM_Test::Hs_Abs_Wheel_Pcnt_Fl;
    Hs_Abs_Wheel_Pcnt_Fr = @sysvar::NBCM_Test::Hs_Abs_Wheel_Pcnt_Fr;
    Hs_Abs_Wheel_Pcnt_Rl = @sysvar::NBCM_Test::Hs_Abs_Wheel_Pcnt_Rl;
    Hs_Abs_Wheel_Pcnt_Rr = @sysvar::NBCM_Test::Hs_Abs_Wheel_Pcnt_Rr;
    Hs_Esc_iTpms_Reset_Progress = @sysvar::NBCM_Test::Hs_Esc_iTpms_Reset_Progress;
    Hs_Esc_iTpms_Status = @sysvar::NBCM_Test::Hs_Esc_iTpms_Status;
    Hs_Esc_PitchAngle = @sysvar::NBCM_Test::Hs_Esc_PitchAngle;
    Hs_Esc_RollAngle = @sysvar::NBCM_Test::Hs_Esc_RollAngle;
    Hs_Esc_YawRate = @sysvar::NBCM_Test::Hs_Esc_YawRate;
    Hs_Diag_Req_Broadcast = @sysvar::NBCM_Test::Hs_Diag_Req_Broadcast;
    Hs_Diag_Req_Icn_Data = @sysvar::NBCM_Test::Hs_Diag_Req_Icn_Data;
    Hs_Diag_Req_Mms_Data = @sysvar::NBCM_Test::Hs_Diag_Req_Mms_Data;
    Hs_Diag_Req_Nbcm_Data = @sysvar::NBCM_Test::Hs_Diag_Req_Nbcm_Data;
    Hs_Diag_Req_Rbg_Data = @sysvar::NBCM_Test::Hs_Diag_Req_Rbg_Data;
    Hs_Ems_Diagnostic_Answer = @sysvar::NBCM_Test::Hs_Ems_Diagnostic_Answer;
    Hs_Eps_Diagnostic_Answer = @sysvar::NBCM_Test::Hs_Eps_Diagnostic_Answer;
    Hs_Icu_Diagnostic_Answer = @sysvar::NBCM_Test::Hs_Icu_Diagnostic_Answer;
    Hs_Tcu_Diagnostic_Answer = @sysvar::NBCM_Test::Hs_Tcu_Diagnostic_Answer;
    Hs_Tpms_Diagnostic_Answer = @sysvar::NBCM_Test::Hs_Tpms_Diagnostic_Answer;
    Hs_Ems_BrakePedalStatus1 = @sysvar::NBCM_Test::Hs_Ems_BrakePedalStatus1;
    Hs_Ems_ClutchPedalStatus = @sysvar::NBCM_Test::Hs_Ems_ClutchPedalStatus;
    Hs_Ems_EngineActualTorque = @sysvar::NBCM_Test::Hs_Ems_EngineActualTorque;
    Hs_Ems_EngineFrictionTorque = @sysvar::NBCM_Test::Hs_Ems_EngineFrictionTorque;
    Hs_Ems_EngineThrottlePosition = @sysvar::NBCM_Test::Hs_Ems_EngineThrottlePosition;
    Hs_Ems_GearEngagedStatus = @sysvar::NBCM_Test::Hs_Ems_GearEngagedStatus;
    Hs_Ems_IndicatedEngineTorque1 = @sysvar::NBCM_Test::Hs_Ems_IndicatedEngineTorque1;
    Hs_Ems_MaxBrkTorq = @sysvar::NBCM_Test::Hs_Ems_MaxBrkTorq;
    Hs_Ems_Vaccumpump_Failure_Status = @sysvar::NBCM_Test::Hs_Ems_Vaccumpump_Failure_Status;
    Hs_Ems_VirtualAccPedal = @sysvar::NBCM_Test::Hs_Ems_VirtualAccPedal;
    Hs_Ems10_Checksum = @sysvar::NBCM_Test::Hs_Ems10_Checksum;
    Hs_Ems10_RollCntr = @sysvar::NBCM_Test::Hs_Ems10_RollCntr;
    Hs_Ems_AccPedalError = @sysvar::NBCM_Test::Hs_Ems_AccPedalError;
    Hs_Ems_AirConditionCommand2 = @sysvar::NBCM_Test::Hs_Ems_AirConditionCommand2;
    Hs_Ems_BrakePedalStatus2 = @sysvar::NBCM_Test::Hs_Ems_BrakePedalStatus2;
    Hs_Ems_Catalyst_Heating_Cycle = @sysvar::NBCM_Test::Hs_Ems_Catalyst_Heating_Cycle;
    Hs_Ems_DrivingCycle = @sysvar::NBCM_Test::Hs_Ems_DrivingCycle;
    Hs_Ems_EngineFuleCutOff = @sysvar::NBCM_Test::Hs_Ems_EngineFuleCutOff;
    Hs_Ems_EngineIntakeAirTemp = @sysvar::NBCM_Test::Hs_Ems_EngineIntakeAirTemp;
    Hs_Ems_F_EngTorqLoss = @sysvar::NBCM_Test::Hs_Ems_F_EngTorqLoss;
    Hs_Ems_N_altitudeFactor = @sysvar::NBCM_Test::Hs_Ems_N_altitudeFactor;
    Hs_Ems_ThrottleValvePosError = @sysvar::NBCM_Test::Hs_Ems_ThrottleValvePosError;
    Hs_Ems_TorqueFailure = @sysvar::NBCM_Test::Hs_Ems_TorqueFailure;
    Hs_Ems_WarmUpCycle = @sysvar::NBCM_Test::Hs_Ems_WarmUpCycle;
    Hs_Ems_ConditionIdle = @sysvar::NBCM_Test::Hs_Ems_ConditionIdle;
    Hs_Ems_CoolanTemperatureError = @sysvar::NBCM_Test::Hs_Ems_CoolanTemperatureError;
    Hs_Ems_DriverReqTorq = @sysvar::NBCM_Test::Hs_Ems_DriverReqTorq;
    Hs_Ems_EngBrkTorqwithoutTCU = @sysvar::NBCM_Test::Hs_Ems_EngBrkTorqwithoutTCU;
    Hs_Ems_EngineIdleSpeedAcitve = @sysvar::NBCM_Test::Hs_Ems_EngineIdleSpeedAcitve;
    Hs_Ems_EngineIdleTargetSpeed = @sysvar::NBCM_Test::Hs_Ems_EngineIdleTargetSpeed;
    Hs_Ems_EngineStatus = @sysvar::NBCM_Test::Hs_Ems_EngineStatus;
    Hs_Ems_MinlndicatedTorq = @sysvar::NBCM_Test::Hs_Ems_MinlndicatedTorq;
    HS_EMS_CRUISE_ON_OFF = @sysvar::NBCM_Test::HS_EMS_CRUISE_ON_OFF;
    Hs_Ems_Cruise_Active = @sysvar::NBCM_Test::Hs_Ems_Cruise_Active;
    Hs_Ems_Cruise_Setpoint = @sysvar::NBCM_Test::Hs_Ems_Cruise_Setpoint;
    Hs_Ems_Speed_Limit_Active = @sysvar::NBCM_Test::Hs_Ems_Speed_Limit_Active;
    Hs_Ems_Speed_limiterStatus = @sysvar::NBCM_Test::Hs_Ems_Speed_limiterStatus;
    Hs_Ems_Ac_Command = @sysvar::NBCM_Test::Hs_Ems_Ac_Command;
    Hs_Ems_Ac_Gasp_Sw1 = @sysvar::NBCM_Test::Hs_Ems_Ac_Gasp_Sw1;
    Hs_Ems_Ac_Gasp_Sw2 = @sysvar::NBCM_Test::Hs_Ems_Ac_Gasp_Sw2;
    Hs_Ems_Check_Engine = @sysvar::NBCM_Test::Hs_Ems_Check_Engine;
    Hs_Ems_EngineSpeedError = @sysvar::NBCM_Test::Hs_Ems_EngineSpeedError;
    Hs_Ems_EobdMil = @sysvar::NBCM_Test::Hs_Ems_EobdMil;
    Hs_Ems_GlowIndicationLamp = @sysvar::NBCM_Test::Hs_Ems_GlowIndicationLamp;
    Hs_Ems_Rpm = @sysvar::NBCM_Test::Hs_Ems_Rpm;
    Hs_Ems_Starter_Inhib = @sysvar::NBCM_Test::Hs_Ems_Starter_Inhib;
    Hs_Ems_Tco_Stop_Lamp = @sysvar::NBCM_Test::Hs_Ems_Tco_Stop_Lamp;
    Hs_Ems_Tco_Value = @sysvar::NBCM_Test::Hs_Ems_Tco_Value;
    Hs_Ems_WaterInFuelLamp = @sysvar::NBCM_Test::Hs_Ems_WaterInFuelLamp;
    Hs_Ems_Cng_Fault_Lamp = @sysvar::NBCM_Test::Hs_Ems_Cng_Fault_Lamp;
    Hs_Ems_Cng_Lamp = @sysvar::NBCM_Test::Hs_Ems_Cng_Lamp;
    Hs_Ems_Cng_Sensor_Err = @sysvar::NBCM_Test::Hs_Ems_Cng_Sensor_Err;
    Hs_Ems_Cng_Tank_Lvl_Out = @sysvar::NBCM_Test::Hs_Ems_Cng_Tank_Lvl_Out;
    Hs_Ems_Distance = @sysvar::NBCM_Test::Hs_Ems_Distance;
    Hs_Ems_Fuel_Tank_Level_Out = @sysvar::NBCM_Test::Hs_Ems_Fuel_Tank_Level_Out;
    Hs_Ems_Fuel_Tank_Sensor_Err = @sysvar::NBCM_Test::Hs_Ems_Fuel_Tank_Sensor_Err;
    Hs_Ems_Mono_Bi_Fuel_Ind = @sysvar::NBCM_Test::Hs_Ems_Mono_Bi_Fuel_Ind;
    Hs_Ems_Fuel_Cons = @sysvar::NBCM_Test::Hs_Ems_Fuel_Cons;
    Hs_Ems_Gear_Engaged_Ind = @sysvar::NBCM_Test::Hs_Ems_Gear_Engaged_Ind;
    Hs_Ems_Gsi_Gear_Info = @sysvar::NBCM_Test::Hs_Ems_Gsi_Gear_Info;
    Hs_Ems_Gsi_Gear_Value = @sysvar::NBCM_Test::Hs_Ems_Gsi_Gear_Value;
    Hs_Ems9_Checksum = @sysvar::NBCM_Test::Hs_Ems9_Checksum;
    Hs_Ems9_RollCntr = @sysvar::NBCM_Test::Hs_Ems9_RollCntr;
    Hs_Ems_ActualAccPedal = @sysvar::NBCM_Test::Hs_Ems_ActualAccPedal;
    Hs_Ems_BrakeEngineTorque2 = @sysvar::NBCM_Test::Hs_Ems_BrakeEngineTorque2;
    Hs_Ems_BrakeTorqueConstant = @sysvar::NBCM_Test::Hs_Ems_BrakeTorqueConstant;
    Hs_Ems_FrictionalTorq = @sysvar::NBCM_Test::Hs_Ems_FrictionalTorq;
    Hs_Ems_Chall_1 = @sysvar::NBCM_Test::Hs_Ems_Chall_1;
    Hs_Ems_Chall_2 = @sysvar::NBCM_Test::Hs_Ems_Chall_2;
    Hs_Ems_Diagnostic_Request = @sysvar::NBCM_Test::Hs_Ems_Diagnostic_Request;
    Hs_Ems_Icu_Dialog = @sysvar::NBCM_Test::Hs_Ems_Icu_Dialog;
    Hs_Ems_LearnPINResp = @sysvar::NBCM_Test::Hs_Ems_LearnPINResp;
    Hs_Ems_LearnSKResp = @sysvar::NBCM_Test::Hs_Ems_LearnSKResp;
    Hs_Ems_Reset_Resp = @sysvar::NBCM_Test::Hs_Ems_Reset_Resp;
    Hs_Ems_Bus_OFF_Counter = @sysvar::NBCM_Test::Hs_Ems_Bus_OFF_Counter;
    Hs_Ems_Com_Loss = @sysvar::NBCM_Test::Hs_Ems_Com_Loss;
    Hs_Ems_Com_Loss_Counter = @sysvar::NBCM_Test::Hs_Ems_Com_Loss_Counter;
    Hs_Ems_Diag_Mode = @sysvar::NBCM_Test::Hs_Ems_Diag_Mode;
    Hs_Ems_ECU_Dynamic_States = @sysvar::NBCM_Test::Hs_Ems_ECU_Dynamic_States;
    Hs_Ems_ECU_Static_States = @sysvar::NBCM_Test::Hs_Ems_ECU_Static_States;
    Hs_Ems_Network_Management_State = @sysvar::NBCM_Test::Hs_Ems_Network_Management_State;
    Hs_Ems_Tx_TimeOut_Counter = @sysvar::NBCM_Test::Hs_Ems_Tx_TimeOut_Counter;
    Hs_Ems_AmbientPressureInvalid = @sysvar::NBCM_Test::Hs_Ems_AmbientPressureInvalid;
    Hs_Ems_AmbintTemp = @sysvar::NBCM_Test::Hs_Ems_AmbintTemp;
    Hs_Ems_TeachSKResp = @sysvar::NBCM_Test::Hs_Ems_TeachSKResp;
    Hs_Epas_Warning = @sysvar::NBCM_Test::Hs_Epas_Warning;
    Hs_Eps_Diagnostic_Request = @sysvar::NBCM_Test::Hs_Eps_Diagnostic_Request;
    Hs_Eps_Bus_OFF_Counter = @sysvar::NBCM_Test::Hs_Eps_Bus_OFF_Counter;
    Hs_Eps_COM_Loss = @sysvar::NBCM_Test::Hs_Eps_COM_Loss;
    Hs_Eps_Com_Loss_Counter = @sysvar::NBCM_Test::Hs_Eps_Com_Loss_Counter;
    Hs_Eps_Diag_Mode = @sysvar::NBCM_Test::Hs_Eps_Diag_Mode;
    Hs_Eps_ECU_Dynamic_States = @sysvar::NBCM_Test::Hs_Eps_ECU_Dynamic_States;
    Hs_Eps_ECU_Static_States = @sysvar::NBCM_Test::Hs_Eps_ECU_Static_States;
    Hs_Eps_Network_Management_State = @sysvar::NBCM_Test::Hs_Eps_Network_Management_State;
    Hs_Eps_Tx_TimeOut_Counter = @sysvar::NBCM_Test::Hs_Eps_Tx_TimeOut_Counter;
    Hs_Sas_Angle = @sysvar::NBCM_Test::Hs_Sas_Angle;
    Hs_Sas_Message_Number = @sysvar::NBCM_Test::Hs_Sas_Message_Number;
    Hs_Sas_Speed = @sysvar::NBCM_Test::Hs_Sas_Speed;
    Hs_Sas_Value_check_message_bytes = @sysvar::NBCM_Test::Hs_Sas_Value_check_message_bytes;
    Hs_Sas_internal_status_flags = @sysvar::NBCM_Test::Hs_Sas_internal_status_flags;
    LS_HVAC_DIAG_RESP = @sysvar::NBCM_Test::LS_HVAC_DIAG_RESP;
    LS_HVAC_FAULT_ID = @sysvar::NBCM_Test::LS_HVAC_FAULT_ID;
    LS_HVAC_FAULT_STATUS = @sysvar::NBCM_Test::LS_HVAC_FAULT_STATUS;
    LS_HVAC_AC_SW = @sysvar::NBCM_Test::LS_HVAC_AC_SW;
    LS_HVAC_INDOOR_TEMP = @sysvar::NBCM_Test::LS_HVAC_INDOOR_TEMP;
    LS_HVAC_SHT_SW = @sysvar::NBCM_Test::LS_HVAC_SHT_SW;
    LS_HVAC_BUSOFF_COUNTER = @sysvar::NBCM_Test::LS_HVAC_BUSOFF_COUNTER;
    LS_HVAC_BUS_ERROR = @sysvar::NBCM_Test::LS_HVAC_BUS_ERROR;
    LS_HVAC_BUS_ERROR_COUNTER = @sysvar::NBCM_Test::LS_HVAC_BUS_ERROR_COUNTER;
    LS_HVAC_COM_LOSS = @sysvar::NBCM_Test::LS_HVAC_COM_LOSS;
    LS_HVAC_COM_LOSS_COUNTER = @sysvar::NBCM_Test::LS_HVAC_COM_LOSS_COUNTER;
    LS_HVAC_DIAG_MODE = @sysvar::NBCM_Test::LS_HVAC_DIAG_MODE;
    LS_HVAC_NBCM_DYN_ABSENT = @sysvar::NBCM_Test::LS_HVAC_NBCM_DYN_ABSENT;
    LS_HVAC_NBCM_STATIC_ABSENT = @sysvar::NBCM_Test::LS_HVAC_NBCM_STATIC_ABSENT;
    LS_HVAC_NM_STATE = @sysvar::NBCM_Test::LS_HVAC_NM_STATE;
    LS_HVAC_TX_TIMEOUT_COUNTER = @sysvar::NBCM_Test::LS_HVAC_TX_TIMEOUT_COUNTER;
    LS_ICN_DEBUG1 = @sysvar::NBCM_Test::LS_ICN_DEBUG1;
    LS_ICN_DEBUG2 = @sysvar::NBCM_Test::LS_ICN_DEBUG2;
    LS_ICN_DEBUG3 = @sysvar::NBCM_Test::LS_ICN_DEBUG3;
    LS_ICN_DEBUG4 = @sysvar::NBCM_Test::LS_ICN_DEBUG4;
    LS_ICN_DEBUG5 = @sysvar::NBCM_Test::LS_ICN_DEBUG5;
    LS_ICN_DEBUG6 = @sysvar::NBCM_Test::LS_ICN_DEBUG6;
    LS_ICN_DEBUG7 = @sysvar::NBCM_Test::LS_ICN_DEBUG7;
    LS_ICN_DEBUG8 = @sysvar::NBCM_Test::LS_ICN_DEBUG8;
    LS_ICN_BACKLIGHT = @sysvar::NBCM_Test::LS_ICN_BACKLIGHT;
    LS_ICN_DIAG_RESP = @sysvar::NBCM_Test::LS_ICN_DIAG_RESP;
    LS_ICN_FAULT_ID = @sysvar::NBCM_Test::LS_ICN_FAULT_ID;
    LS_ICN_FAULT_STATUS = @sysvar::NBCM_Test::LS_ICN_FAULT_STATUS;
    LS_ICN_AVS = @sysvar::NBCM_Test::LS_ICN_AVS;
    LS_ICN_MAINT_DIST = @sysvar::NBCM_Test::LS_ICN_MAINT_DIST;
    LS_ICN_CHANGE_AIRF = @sysvar::NBCM_Test::LS_ICN_CHANGE_AIRF;
    LS_ICN_CHANGE_OIL = @sysvar::NBCM_Test::LS_ICN_CHANGE_OIL;
    LS_ICN_CHANGE_OILF = @sysvar::NBCM_Test::LS_ICN_CHANGE_OILF;
    LS_ICN_ODO = @sysvar::NBCM_Test::LS_ICN_ODO;
    LS_ICN_BUSOFF_COUNTER = @sysvar::NBCM_Test::LS_ICN_BUSOFF_COUNTER;
    LS_ICN_BUS_ERROR = @sysvar::NBCM_Test::LS_ICN_BUS_ERROR;
    LS_ICN_BUS_ERROR_COUNTER = @sysvar::NBCM_Test::LS_ICN_BUS_ERROR_COUNTER;
    LS_ICN_COM_LOSS = @sysvar::NBCM_Test::LS_ICN_COM_LOSS;
    LS_ICN_COM_LOSS_COUNTER = @sysvar::NBCM_Test::LS_ICN_COM_LOSS_COUNTER;
    LS_ICN_DIAG_MODE = @sysvar::NBCM_Test::LS_ICN_DIAG_MODE;
    LS_ICN_NBCM_DYN_ABSENT = @sysvar::NBCM_Test::LS_ICN_NBCM_DYN_ABSENT;
    LS_ICN_NBCM_STATIC_ABSENT = @sysvar::NBCM_Test::LS_ICN_NBCM_STATIC_ABSENT;
    LS_ICN_NM_STATE = @sysvar::NBCM_Test::LS_ICN_NM_STATE;
    LS_ICN_TX_TIMEOUT_COUNTER = @sysvar::NBCM_Test::LS_ICN_TX_TIMEOUT_COUNTER;
    LS_ICN_DATE_DAY = @sysvar::NBCM_Test::LS_ICN_DATE_DAY;
    LS_ICN_DATE_MONTH = @sysvar::NBCM_Test::LS_ICN_DATE_MONTH;
    LS_ICN_DATE_YEAR = @sysvar::NBCM_Test::LS_ICN_DATE_YEAR;
    LS_ICN_TIME_HOURS = @sysvar::NBCM_Test::LS_ICN_TIME_HOURS;
    LS_ICN_TIME_MINUTES = @sysvar::NBCM_Test::LS_ICN_TIME_MINUTES;
    LS_ICN_TIME_SECONDS = @sysvar::NBCM_Test::LS_ICN_TIME_SECONDS;
    LS_ICN_DIAG_RESP = @sysvar::NBCM_Test::LS_ICN_DIAG_RESP;
    LS_ICN_FAULT_ID = @sysvar::NBCM_Test::LS_ICN_FAULT_ID;
    LS_ICN_FAULT_STATUS = @sysvar::NBCM_Test::LS_ICN_FAULT_STATUS;
    LS_ICN_OUT_TEMP = @sysvar::NBCM_Test::LS_ICN_OUT_TEMP;
    LS_ICN_BACKLIGHT = @sysvar::NBCM_Test::LS_ICN_BACKLIGHT;
    LS_ICN_LOW_FLW = @sysvar::NBCM_Test::LS_ICN_LOW_FLW;
    LS_ICN_ODO = @sysvar::NBCM_Test::LS_ICN_ODO;
    LS_ICN_SPD_GWY = @sysvar::NBCM_Test::LS_ICN_SPD_GWY;
    LS_ICN_BUSOFF_COUNTER = @sysvar::NBCM_Test::LS_ICN_BUSOFF_COUNTER;
    LS_ICN_BUS_ERROR = @sysvar::NBCM_Test::LS_ICN_BUS_ERROR;
    LS_ICN_BUS_ERROR_COUNTER = @sysvar::NBCM_Test::LS_ICN_BUS_ERROR_COUNTER;
    LS_ICN_COM_LOSS = @sysvar::NBCM_Test::LS_ICN_COM_LOSS;
    LS_ICN_COM_LOSS_COUNTER = @sysvar::NBCM_Test::LS_ICN_COM_LOSS_COUNTER;
    LS_ICN_DIAG_MODE = @sysvar::NBCM_Test::LS_ICN_DIAG_MODE;
    LS_ICN_NBCM_DYN_ABSENT = @sysvar::NBCM_Test::LS_ICN_NBCM_DYN_ABSENT;
    LS_ICN_NBCM_STATIC_ABSENT = @sysvar::NBCM_Test::LS_ICN_NBCM_STATIC_ABSENT;
    LS_ICN_NM_STATE = @sysvar::NBCM_Test::LS_ICN_NM_STATE;
    LS_ICN_TX_TIMEOUT_COUNTER = @sysvar::NBCM_Test::LS_ICN_TX_TIMEOUT_COUNTER;
    LS_ICN_VERSION_MAJOR = @sysvar::NBCM_Test::LS_ICN_VERSION_MAJOR;
    LS_ICN_VERSION_MINOR = @sysvar::NBCM_Test::LS_ICN_VERSION_MINOR;
    Ls_Icn_Abs_Ehb_FaultLamp = @sysvar::NBCM_Test::Ls_Icn_Abs_Ehb_FaultLamp;
    Ls_Icn_BattCharge_FaultLamp = @sysvar::NBCM_Test::Ls_Icn_BattCharge_FaultLamp;
    Ls_Icn_Brake_Fluid_AlarmLamp = @sysvar::NBCM_Test::Ls_Icn_Brake_Fluid_AlarmLamp;
    Ls_Icn_Door_Open_Lamp = @sysvar::NBCM_Test::Ls_Icn_Door_Open_Lamp;
    Ls_Icn_ElecBrkSplit_FaultLmp = @sysvar::NBCM_Test::Ls_Icn_ElecBrkSplit_FaultLmp;
    Ls_Icn_Elec_Genrt_Fault_Lamp = @sysvar::NBCM_Test::Ls_Icn_Elec_Genrt_Fault_Lamp;
    Ls_Icn_Esp_Asr_FaultLamp = @sysvar::NBCM_Test::Ls_Icn_Esp_Asr_FaultLamp;
    Ls_Icn_FootOnBrake_Lamp = @sysvar::NBCM_Test::Ls_Icn_FootOnBrake_Lamp;
    Ls_Icn_Low_Fuel_Lamp = @sysvar::NBCM_Test::Ls_Icn_Low_Fuel_Lamp;
    Ls_Icn_OilPressure_AlarmLamp = @sysvar::NBCM_Test::Ls_Icn_OilPressure_AlarmLamp;
    Ls_Icn_ParkingBrakeLamp = @sysvar::NBCM_Test::Ls_Icn_ParkingBrakeLamp;
    Ls_Icn_PasAirbagInhibLamp = @sysvar::NBCM_Test::Ls_Icn_PasAirbagInhibLamp;
    Ls_Icn_PassiveSafty_FaultLmp = @sysvar::NBCM_Test::Ls_Icn_PassiveSafty_FaultLmp;
    Ls_Icn_PowerSteeringFaultLamp = @sysvar::NBCM_Test::Ls_Icn_PowerSteeringFaultLamp;
    Ls_Icn_Service_Lamp = @sysvar::NBCM_Test::Ls_Icn_Service_Lamp;
    Ls_Icn_Stop_Lamp = @sysvar::NBCM_Test::Ls_Icn_Stop_Lamp;
    Ls_Icn_Tpms_AlarmLamp = @sysvar::NBCM_Test::Ls_Icn_Tpms_AlarmLamp;
    Ls_Icn_WaterTemp_AlarmLamp = @sysvar::NBCM_Test::Ls_Icn_WaterTemp_AlarmLamp;
    Ls_Icu_Key_Inside = @sysvar::NBCM_Test::Ls_Icu_Key_Inside;
    Ls_Icu_TP_Position = @sysvar::NBCM_Test::Ls_Icu_TP_Position;
    Ls_Icn_Mileage = @sysvar::NBCM_Test::Ls_Icn_Mileage;
    Ls_Icn_Mileage_Comp = @sysvar::NBCM_Test::Ls_Icn_Mileage_Comp;
    Ls_Icn_Uds_Resp = @sysvar::NBCM_Test::Ls_Icn_Uds_Resp;
    Ls_Icn_Abs_Unit1 = @sysvar::NBCM_Test::Ls_Icn_Abs_Unit1;
    Ls_Icn_Abs_Unit2 = @sysvar::NBCM_Test::Ls_Icn_Abs_Unit2;
    Ls_Icn_Abs_Unit3 = @sysvar::NBCM_Test::Ls_Icn_Abs_Unit3;
    Ls_Icn_Busoff_Cnt = @sysvar::NBCM_Test::Ls_Icn_Busoff_Cnt;
    Ls_Icn_Comloss_Cnt = @sysvar::NBCM_Test::Ls_Icn_Comloss_Cnt;
    Ls_Icn_Comloss_Fault = @sysvar::NBCM_Test::Ls_Icn_Comloss_Fault;
    Ls_Icn_Nas_Cnt = @sysvar::NBCM_Test::Ls_Icn_Nas_Cnt;
    Ls_Icn_Nerr = @sysvar::NBCM_Test::Ls_Icn_Nerr;
    Ls_Icn_Nerr_Cnt = @sysvar::NBCM_Test::Ls_Icn_Nerr_Cnt;
    Ls_Icn_Nm_St = @sysvar::NBCM_Test::Ls_Icn_Nm_St;
    Ls_Icn_Ecu_Num = @sysvar::NBCM_Test::Ls_Icn_Ecu_Num;
    Ls_Icn_Msg_Tab_Dig1 = @sysvar::NBCM_Test::Ls_Icn_Msg_Tab_Dig1;
    Ls_Icn_Msg_Tab_Dig2 = @sysvar::NBCM_Test::Ls_Icn_Msg_Tab_Dig2;
    Ls_Icn_Msg_Tab_Edition = @sysvar::NBCM_Test::Ls_Icn_Msg_Tab_Edition;
    Ls_Icn_Sw_Ident = @sysvar::NBCM_Test::Ls_Icn_Sw_Ident;
    Ls_Icn_Sw_Ver_Day = @sysvar::NBCM_Test::Ls_Icn_Sw_Ver_Day;
    Ls_Icn_Sw_Ver_Month = @sysvar::NBCM_Test::Ls_Icn_Sw_Ver_Month;
    Ls_Icn_Sw_Ver_Year = @sysvar::NBCM_Test::Ls_Icn_Sw_Ver_Year;
    Ls_Icn_Dist_Unit = @sysvar::NBCM_Test::Ls_Icn_Dist_Unit;
    Ls_Icn_Esp_Sw_Req = @sysvar::NBCM_Test::Ls_Icn_Esp_Sw_Req;
    Ls_Icn_Maint_Reset_Req = @sysvar::NBCM_Test::Ls_Icn_Maint_Reset_Req;
    Ls_Icn_Rbg_Fault_St = @sysvar::NBCM_Test::Ls_Icn_Rbg_Fault_St;
    Ls_Icn_Rbg_Inhib_St = @sysvar::NBCM_Test::Ls_Icn_Rbg_Inhib_St;
    Ls_Icn_Reset_Partial_Odo = @sysvar::NBCM_Test::Ls_Icn_Reset_Partial_Odo;
    Ls_Icn_Reset_Tot_Trip1 = @sysvar::NBCM_Test::Ls_Icn_Reset_Tot_Trip1;
    Ls_Icn_Speed_Display = @sysvar::NBCM_Test::Ls_Icn_Speed_Display;
    Ls_Icn_Dtc_Info = @sysvar::NBCM_Test::Ls_Icn_Dtc_Info;
    Ls_Icn_Frame_Index = @sysvar::NBCM_Test::Ls_Icn_Frame_Index;
    Ls_Icn_Frame_Nb = @sysvar::NBCM_Test::Ls_Icn_Frame_Nb;
    Hs_Icu_Diagnostic_Request = @sysvar::NBCM_Test::Hs_Icu_Diagnostic_Request;
    Hs_Icu_Ems_dialog = @sysvar::NBCM_Test::Hs_Icu_Ems_dialog;
    Hs_Icu_Ems_Status = @sysvar::NBCM_Test::Hs_Icu_Ems_Status;
    Hs_Icu_Immo_Hardware_Version = @sysvar::NBCM_Test::Hs_Icu_Immo_Hardware_Version;
    Hs_Icu_Immo_Lamp_Command = @sysvar::NBCM_Test::Hs_Icu_Immo_Lamp_Command;
    Hs_Icu_Immo_Output_Lamp_St = @sysvar::NBCM_Test::Hs_Icu_Immo_Output_Lamp_St;
    Hs_Icu_Immo_Production_Date = @sysvar::NBCM_Test::Hs_Icu_Immo_Production_Date;
    Hs_Icu_Immo_Software_Version = @sysvar::NBCM_Test::Hs_Icu_Immo_Software_Version;
    Hs_Icu_Key_Inside = @sysvar::NBCM_Test::Hs_Icu_Key_Inside;
    Hs_Icu_Tp_Position = @sysvar::NBCM_Test::Hs_Icu_Tp_Position;
    Hs_Icu_Reset_Req_1 = @sysvar::NBCM_Test::Hs_Icu_Reset_Req_1;
    Hs_Icu_Reset_Req_2 = @sysvar::NBCM_Test::Hs_Icu_Reset_Req_2;
    Hs_Icu_Bus_OFF_Counter = @sysvar::NBCM_Test::Hs_Icu_Bus_OFF_Counter;
    Hs_Icu_Com_Loss = @sysvar::NBCM_Test::Hs_Icu_Com_Loss;
    Hs_Icu_Com_Loss_Counter = @sysvar::NBCM_Test::Hs_Icu_Com_Loss_Counter;
    Hs_Icu_Diag_Mode = @sysvar::NBCM_Test::Hs_Icu_Diag_Mode;
    Hs_Icu_Ecu_Dynamic_States = @sysvar::NBCM_Test::Hs_Icu_Ecu_Dynamic_States;
    Hs_Icu_Ecu_Static_States = @sysvar::NBCM_Test::Hs_Icu_Ecu_Static_States;
    Hs_Icu_Net_Management_State = @sysvar::NBCM_Test::Hs_Icu_Net_Management_State;
    Hs_Icu_Tx_TimeOut_Counter = @sysvar::NBCM_Test::Hs_Icu_Tx_TimeOut_Counter;
    Hs_Imm_Auth_1 = @sysvar::NBCM_Test::Hs_Imm_Auth_1;
    Hs_Imm_Auth_2 = @sysvar::NBCM_Test::Hs_Imm_Auth_2;
    Hs_Imm_LearnSKReq_1 = @sysvar::NBCM_Test::Hs_Imm_LearnSKReq_1;
    Hs_Imm_LearnSKReq_2 = @sysvar::NBCM_Test::Hs_Imm_LearnSKReq_2;
    Hs_Imm_TeachPINReq_1 = @sysvar::NBCM_Test::Hs_Imm_TeachPINReq_1;
    Hs_Imm_TeachPINReq_2 = @sysvar::NBCM_Test::Hs_Imm_TeachPINReq_2;
    Hs_Imm_TeachSKReq = @sysvar::NBCM_Test::Hs_Imm_TeachSKReq;
    Hs_iTMPS_Fault_MMS = @sysvar::NBCM_Test::Hs_iTMPS_Fault_MMS;
    Hs_iTPMS_Check_Tire_Pressure = @sysvar::NBCM_Test::Hs_iTPMS_Check_Tire_Pressure;
    Hs_iTPMS_Fault_ICN = @sysvar::NBCM_Test::Hs_iTPMS_Fault_ICN;
    Hs_iTPMS_Reset_Condition_NO = @sysvar::NBCM_Test::Hs_iTPMS_Reset_Condition_NO;
    Hs_iTPMS_Tire_Pressure_Reg = @sysvar::NBCM_Test::Hs_iTPMS_Tire_Pressure_Reg;
    LS_MMS_DIAG_RESP = @sysvar::NBCM_Test::LS_MMS_DIAG_RESP;
    Ls_Mms_Icn_Set_Day = @sysvar::NBCM_Test::Ls_Mms_Icn_Set_Day;
    Ls_Mms_Icn_Set_Hour = @sysvar::NBCM_Test::Ls_Mms_Icn_Set_Hour;
    Ls_Mms_Icn_Set_Hour_Mode = @sysvar::NBCM_Test::Ls_Mms_Icn_Set_Hour_Mode;
    Ls_Mms_Icn_Set_Min = @sysvar::NBCM_Test::Ls_Mms_Icn_Set_Min;
    Ls_Mms_Icn_Set_Month = @sysvar::NBCM_Test::Ls_Mms_Icn_Set_Month;
    Ls_Mms_Icn_Set_Year = @sysvar::NBCM_Test::Ls_Mms_Icn_Set_Year;
    Ls_Mms_Amb_Bkl_Level = @sysvar::NBCM_Test::Ls_Mms_Amb_Bkl_Level;
    Ls_Mms_Bluetooth_Active = @sysvar::NBCM_Test::Ls_Mms_Bluetooth_Active;
    Ls_Mms_Config_Valid = @sysvar::NBCM_Test::Ls_Mms_Config_Valid;
    Ls_Mms_Drl_Active = @sysvar::NBCM_Test::Ls_Mms_Drl_Active;
    Ls_Mms_Esc_Active = @sysvar::NBCM_Test::Ls_Mms_Esc_Active;
    Ls_Mms_Pas_Func_Permanent = @sysvar::NBCM_Test::Ls_Mms_Pas_Func_Permanent;
    Ls_Mms_Pas_Func_Temporary = @sysvar::NBCM_Test::Ls_Mms_Pas_Func_Temporary;
    Ls_Mms_Recognize_Trip = @sysvar::NBCM_Test::Ls_Mms_Recognize_Trip;
    Ls_Mms_Request_Trip1_reset = @sysvar::NBCM_Test::Ls_Mms_Request_Trip1_reset;
    Ls_Mms_Request_Trip2_reset = @sysvar::NBCM_Test::Ls_Mms_Request_Trip2_reset;
    Ls_Mms_Road_Finder_Active = @sysvar::NBCM_Test::Ls_Mms_Road_Finder_Active;
    Ls_Mms_Road_Finder_Time = @sysvar::NBCM_Test::Ls_Mms_Road_Finder_Time;
    Ls_Mms_Tpms_Active_Req = @sysvar::NBCM_Test::Ls_Mms_Tpms_Active_Req;
    Ls_Mms_Dtc_Info = @sysvar::NBCM_Test::Ls_Mms_Dtc_Info;
    Ls_Mms_Frame_Index = @sysvar::NBCM_Test::Ls_Mms_Frame_Index;
    Ls_Mms_Frame_Nb = @sysvar::NBCM_Test::Ls_Mms_Frame_Nb;
    Ls_Mms_Uds_Resp = @sysvar::NBCM_Test::Ls_Mms_Uds_Resp;
    Ls_Mms_Abs_Unit1 = @sysvar::NBCM_Test::Ls_Mms_Abs_Unit1;
    Ls_Mms_Abs_Unit2 = @sysvar::NBCM_Test::Ls_Mms_Abs_Unit2;
    Ls_Mms_Abs_Unit3 = @sysvar::NBCM_Test::Ls_Mms_Abs_Unit3;
    Ls_Mms_Busoff_Cnt = @sysvar::NBCM_Test::Ls_Mms_Busoff_Cnt;
    Ls_Mms_Comloss_Cnt = @sysvar::NBCM_Test::Ls_Mms_Comloss_Cnt;
    Ls_Mms_Comloss_Fault = @sysvar::NBCM_Test::Ls_Mms_Comloss_Fault;
    Ls_Mms_Nas_Cnt = @sysvar::NBCM_Test::Ls_Mms_Nas_Cnt;
    Ls_Mms_Nerr = @sysvar::NBCM_Test::Ls_Mms_Nerr;
    Ls_Mms_Nerr_Cnt = @sysvar::NBCM_Test::Ls_Mms_Nerr_Cnt;
    Ls_Mms_Nm_St = @sysvar::NBCM_Test::Ls_Mms_Nm_St;
    Ls_Mms_Ecu_Num = @sysvar::NBCM_Test::Ls_Mms_Ecu_Num;
    Ls_Mms_Msg_Tab_Dig1 = @sysvar::NBCM_Test::Ls_Mms_Msg_Tab_Dig1;
    Ls_Mms_Msg_Tab_Dig2 = @sysvar::NBCM_Test::Ls_Mms_Msg_Tab_Dig2;
    Ls_Mms_Msg_Tab_Edition = @sysvar::NBCM_Test::Ls_Mms_Msg_Tab_Edition;
    Ls_Mms_Sw_Ident = @sysvar::NBCM_Test::Ls_Mms_Sw_Ident;
    Ls_Mms_Sw_Ver_Day = @sysvar::NBCM_Test::Ls_Mms_Sw_Ver_Day;
    Ls_Mms_Sw_Ver_Month = @sysvar::NBCM_Test::Ls_Mms_Sw_Ver_Month;
    Ls_Mms_Sw_Ver_Year = @sysvar::NBCM_Test::Ls_Mms_Sw_Ver_Year;
    LS_ICN_DATE_DAY = @sysvar::NBCM_Test::LS_ICN_DATE_DAY;
    LS_ICN_DATE_MONTH = @sysvar::NBCM_Test::LS_ICN_DATE_MONTH;
    LS_ICN_DATE_YEAR = @sysvar::NBCM_Test::LS_ICN_DATE_YEAR;
    LS_ICN_TIME_HOURS = @sysvar::NBCM_Test::LS_ICN_TIME_HOURS;
    LS_ICN_TIME_MINUTES = @sysvar::NBCM_Test::LS_ICN_TIME_MINUTES;
    LS_ICN_TIME_SECONDS = @sysvar::NBCM_Test::LS_ICN_TIME_SECONDS;
    Hs_Peps_AuthFailWarning = @sysvar::NBCM_Test::Hs_Peps_AuthFailWarning;
    Hs_Peps_AuthenticationSt = @sysvar::NBCM_Test::Hs_Peps_AuthenticationSt;
    Hs_Peps_BrakeSwitchSt = @sysvar::NBCM_Test::Hs_Peps_BrakeSwitchSt;
    Hs_Peps_ClutchSwitchSt = @sysvar::NBCM_Test::Hs_Peps_ClutchSwitchSt;
    Hs_Peps_DeactivationWarning = @sysvar::NBCM_Test::Hs_Peps_DeactivationWarning;
    Hs_Peps_DoorLockReq = @sysvar::NBCM_Test::Hs_Peps_DoorLockReq;
    Hs_Peps_DoorLockWarning = @sysvar::NBCM_Test::Hs_Peps_DoorLockWarning;
    Hs_Peps_DoorUnlockReq = @sysvar::NBCM_Test::Hs_Peps_DoorUnlockReq;
    Hs_Peps_DriverButtonSt = @sysvar::NBCM_Test::Hs_Peps_DriverButtonSt;
    Hs_Peps_ESCLLearntMode = @sysvar::NBCM_Test::Hs_Peps_ESCLLearntMode;
    Hs_Peps_ESCLLockEnPowerSupplySt = @sysvar::NBCM_Test::Hs_Peps_ESCLLockEnPowerSupplySt;
    Hs_Peps_ESCLMotorPowerSupplySt = @sysvar::NBCM_Test::Hs_Peps_ESCLMotorPowerSupplySt;
    Hs_Peps_ESCLUnlockSt = @sysvar::NBCM_Test::Hs_Peps_ESCLUnlockSt;
    Hs_Peps_ESCLWarning = @sysvar::NBCM_Test::Hs_Peps_ESCLWarning;
    Hs_Peps_FOB_ID = @sysvar::NBCM_Test::Hs_Peps_FOB_ID;
    Hs_Peps_FobBattLowWarning = @sysvar::NBCM_Test::Hs_Peps_FobBattLowWarning;
    Hs_Peps_KeyOutWarning = @sysvar::NBCM_Test::Hs_Peps_KeyOutWarning;
    Hs_Peps_LearntMode = @sysvar::NBCM_Test::Hs_Peps_LearntMode;
    Hs_Peps_OpIndicationWarning = @sysvar::NBCM_Test::Hs_Peps_OpIndicationWarning;
    Hs_Peps_PasserngerButtonSt = @sysvar::NBCM_Test::Hs_Peps_PasserngerButtonSt;
    Hs_Peps_SSBWarning = @sysvar::NBCM_Test::Hs_Peps_SSBWarning;
    Hs_Peps_SSB_SW1St = @sysvar::NBCM_Test::Hs_Peps_SSB_SW1St;
    Hs_Peps_SSB_SW2St = @sysvar::NBCM_Test::Hs_Peps_SSB_SW2St;
    Hs_Peps_SysPowMode = @sysvar::NBCM_Test::Hs_Peps_SysPowMode;
    Hs_Peps_TrunkReq = @sysvar::NBCM_Test::Hs_Peps_TrunkReq;
    Hs_Peps_VehSpd = @sysvar::NBCM_Test::Hs_Peps_VehSpd;
    Hs_Peps_VehSpdVD = @sysvar::NBCM_Test::Hs_Peps_VehSpdVD;
    Hs_Peps_VehSpdWarning = @sysvar::NBCM_Test::Hs_Peps_VehSpdWarning;
    Hs_Peps_keyComdInfo = @sysvar::NBCM_Test::Hs_Peps_keyComdInfo;
    Ls_Rbg_Crash_Info = @sysvar::NBCM_Test::Ls_Rbg_Crash_Info;
    Ls_Rbg_Dtc_Info = @sysvar::NBCM_Test::Ls_Rbg_Dtc_Info;
    Ls_Rbg_Frame_Index = @sysvar::NBCM_Test::Ls_Rbg_Frame_Index;
    Ls_Rbg_Frame_Nb = @sysvar::NBCM_Test::Ls_Rbg_Frame_Nb;
    Ls_Rbg_Checksum = @sysvar::NBCM_Test::Ls_Rbg_Checksum;
    Ls_Rbg_Fault = @sysvar::NBCM_Test::Ls_Rbg_Fault;
    Ls_Rbg_Pass_Inhib = @sysvar::NBCM_Test::Ls_Rbg_Pass_Inhib;
    Ls_Rbg_Process_Cnt = @sysvar::NBCM_Test::Ls_Rbg_Process_Cnt;
    Ls_Rbg_Uds_Resp = @sysvar::NBCM_Test::Ls_Rbg_Uds_Resp;
    Ls_Rbg_Abs_Unit1 = @sysvar::NBCM_Test::Ls_Rbg_Abs_Unit1;
    Ls_Rbg_Abs_Unit2 = @sysvar::NBCM_Test::Ls_Rbg_Abs_Unit2;
    Ls_Rbg_Abs_Unit3 = @sysvar::NBCM_Test::Ls_Rbg_Abs_Unit3;
    Ls_Rbg_Busoff_Cnt = @sysvar::NBCM_Test::Ls_Rbg_Busoff_Cnt;
    Ls_Rbg_Comloss_Cnt = @sysvar::NBCM_Test::Ls_Rbg_Comloss_Cnt;
    Ls_Rbg_Comloss_Fault = @sysvar::NBCM_Test::Ls_Rbg_Comloss_Fault;
    Ls_Rbg_Nas_Cnt = @sysvar::NBCM_Test::Ls_Rbg_Nas_Cnt;
    Ls_Rbg_Nerr = @sysvar::NBCM_Test::Ls_Rbg_Nerr;
    Ls_Rbg_Nerr_Cnt = @sysvar::NBCM_Test::Ls_Rbg_Nerr_Cnt;
    Ls_Rbg_Nm_St = @sysvar::NBCM_Test::Ls_Rbg_Nm_St;
    Ls_Rbg_Ecu_Num = @sysvar::NBCM_Test::Ls_Rbg_Ecu_Num;
    Ls_Rbg_Msg_Tab_Dig1 = @sysvar::NBCM_Test::Ls_Rbg_Msg_Tab_Dig1;
    Ls_Rbg_Msg_Tab_Dig2 = @sysvar::NBCM_Test::Ls_Rbg_Msg_Tab_Dig2;
    Ls_Rbg_Msg_Tab_Edition = @sysvar::NBCM_Test::Ls_Rbg_Msg_Tab_Edition;
    Ls_Rbg_Sw_Ident = @sysvar::NBCM_Test::Ls_Rbg_Sw_Ident;
    Ls_Rbg_Sw_Ver_Day = @sysvar::NBCM_Test::Ls_Rbg_Sw_Ver_Day;
    Ls_Rbg_Sw_Ver_Month = @sysvar::NBCM_Test::Ls_Rbg_Sw_Ver_Month;
    Ls_Rbg_Sw_Ver_Year = @sysvar::NBCM_Test::Ls_Rbg_Sw_Ver_Year;
    Hs_Tcu_Diagnostic_Request = @sysvar::NBCM_Test::Hs_Tcu_Diagnostic_Request;
    Hs_Tcu_ActualGearValid = @sysvar::NBCM_Test::Hs_Tcu_ActualGearValid;
    Hs_Tcu_Current_Gear = @sysvar::NBCM_Test::Hs_Tcu_Current_Gear;
    Hs_Tcu_DriverMode = @sysvar::NBCM_Test::Hs_Tcu_DriverMode;
    Hs_Tcu_EngBrkTorqReductValue = @sysvar::NBCM_Test::Hs_Tcu_EngBrkTorqReductValue;
    Hs_Tcu_Gear_Lever_Pos = @sysvar::NBCM_Test::Hs_Tcu_Gear_Lever_Pos;
    Hs_Tcu_Info_1_Checksum = @sysvar::NBCM_Test::Hs_Tcu_Info_1_Checksum;
    Hs_Tcu_Info_1_RollCntr = @sysvar::NBCM_Test::Hs_Tcu_Info_1_RollCntr;
    Hs_Tcu_Mil_Req_Mil_On = @sysvar::NBCM_Test::Hs_Tcu_Mil_Req_Mil_On;
    Hs_Tcu_N_EngBrkTorqLimitValue = @sysvar::NBCM_Test::Hs_Tcu_N_EngBrkTorqLimitValue;
    Hs_Tcu_ReverseControl = @sysvar::NBCM_Test::Hs_Tcu_ReverseControl;
    Hs_Tcu_ShiftInProgress = @sysvar::NBCM_Test::Hs_Tcu_ShiftInProgress;
    Hs_Tcu_TargetGear = @sysvar::NBCM_Test::Hs_Tcu_TargetGear;
    Hs_Tcu_TargetGearValid = @sysvar::NBCM_Test::Hs_Tcu_TargetGearValid;
    Hs_Tcu_TorqConvClutchStatus = @sysvar::NBCM_Test::Hs_Tcu_TorqConvClutchStatus;
    Hs_Tcu_TorqLimitationReq = @sysvar::NBCM_Test::Hs_Tcu_TorqLimitationReq;
    Hs_Tcu_TransmissionFailureStatus = @sysvar::NBCM_Test::Hs_Tcu_TransmissionFailureStatus;
    Hs_Tcu_TransmissionOilTemp = @sysvar::NBCM_Test::Hs_Tcu_TransmissionOilTemp;
    Hs_Tcu_CoolFanReq = @sysvar::NBCM_Test::Hs_Tcu_CoolFanReq;
    Hs_Tcu_EngBrkTorqIncreValue = @sysvar::NBCM_Test::Hs_Tcu_EngBrkTorqIncreValue;
    Hs_Tcu_Info_2_Checksum = @sysvar::NBCM_Test::Hs_Tcu_Info_2_Checksum;
    Hs_Tcu_Info_2_RollCntr = @sysvar::NBCM_Test::Hs_Tcu_Info_2_RollCntr;
    Hs_Tcu_ShiftPositionValid = @sysvar::NBCM_Test::Hs_Tcu_ShiftPositionValid;
    Hs_Tcu_TorqConvTurbineSpeed = @sysvar::NBCM_Test::Hs_Tcu_TorqConvTurbineSpeed;
    Hs_Tcu_TorqIncreReq = @sysvar::NBCM_Test::Hs_Tcu_TorqIncreReq;
    Hs_Tcu_TorqReductReq = @sysvar::NBCM_Test::Hs_Tcu_TorqReductReq;
    Hs_Tcu_CrankingEnable = @sysvar::NBCM_Test::Hs_Tcu_CrankingEnable;
    Hs_Tcu_DesiredEngIdlSpdReq = @sysvar::NBCM_Test::Hs_Tcu_DesiredEngIdlSpdReq;
    Hs_Tcu_DesiredEngIdlSpdReqActive = @sysvar::NBCM_Test::Hs_Tcu_DesiredEngIdlSpdReqActive;
    Hs_Tcu_IdleContLoadTorqInvalid = @sysvar::NBCM_Test::Hs_Tcu_IdleContLoadTorqInvalid;
    Hs_Tcu_IdleControlLoadTorque = @sysvar::NBCM_Test::Hs_Tcu_IdleControlLoadTorque;
    Hs_Tcu_LaunchVehicle = @sysvar::NBCM_Test::Hs_Tcu_LaunchVehicle;
    Hs_Tcu_MaxEngSpeedLimReq = @sysvar::NBCM_Test::Hs_Tcu_MaxEngSpeedLimReq;
    Hs_Tcu_OutputShaftSpeed = @sysvar::NBCM_Test::Hs_Tcu_OutputShaftSpeed;
    Hs_Tcu_OvertempLevel = @sysvar::NBCM_Test::Hs_Tcu_OvertempLevel;
    Hs_Tcu_Bus_OFF_Counter = @sysvar::NBCM_Test::Hs_Tcu_Bus_OFF_Counter;
    Hs_Tcu_Com_Loss = @sysvar::NBCM_Test::Hs_Tcu_Com_Loss;
    Hs_Tcu_Com_Loss_Counter = @sysvar::NBCM_Test::Hs_Tcu_Com_Loss_Counter;
    Hs_Tcu_Diag_Mode = @sysvar::NBCM_Test::Hs_Tcu_Diag_Mode;
    Hs_Tcu_Ecu_Dynamic_States = @sysvar::NBCM_Test::Hs_Tcu_Ecu_Dynamic_States;
    Hs_Tcu_Ecu_Static_States = @sysvar::NBCM_Test::Hs_Tcu_Ecu_Static_States;
    Hs_Tcu_Network_Management_State = @sysvar::NBCM_Test::Hs_Tcu_Network_Management_State;
    Hs_Tcu_Tx_TimeOut_Counter = @sysvar::NBCM_Test::Hs_Tcu_Tx_TimeOut_Counter;
    Hs_Tpms_Diagnostic_Request = @sysvar::NBCM_Test::Hs_Tpms_Diagnostic_Request;
    Hs_TpmsLearningSt = @sysvar::NBCM_Test::Hs_TpmsLearningSt;
    Hs_Tpms_SystemSt = @sysvar::NBCM_Test::Hs_Tpms_SystemSt;
    Hs_Tpms_TireBatteryPowerSt = @sysvar::NBCM_Test::Hs_Tpms_TireBatteryPowerSt;
    Hs_Tpms_TireId = @sysvar::NBCM_Test::Hs_Tpms_TireId;
    Hs_Tpms_TireInfoInvalid = @sysvar::NBCM_Test::Hs_Tpms_TireInfoInvalid;
    Hs_Tpms_TireLeakage = @sysvar::NBCM_Test::Hs_Tpms_TireLeakage;
    Hs_Tpms_TirePressure = @sysvar::NBCM_Test::Hs_Tpms_TirePressure;
    Hs_Tpms_TirePressureSt = @sysvar::NBCM_Test::Hs_Tpms_TirePressureSt;
    Hs_Tpms_TireTemperature = @sysvar::NBCM_Test::Hs_Tpms_TireTemperature;
    Hs_Tpms_TireTemperatureSt = @sysvar::NBCM_Test::Hs_Tpms_TireTemperatureSt;
    Hs_Tpms_Bus_OFF_Counter = @sysvar::NBCM_Test::Hs_Tpms_Bus_OFF_Counter;
    Hs_Tpms_COM_Loss = @sysvar::NBCM_Test::Hs_Tpms_COM_Loss;
    Hs_Tpms_Com_Loss_Counter = @sysvar::NBCM_Test::Hs_Tpms_Com_Loss_Counter;
    Hs_Tpms_Diag_Mode = @sysvar::NBCM_Test::Hs_Tpms_Diag_Mode;
    Hs_Tpms_ECU_Dynamic_States = @sysvar::NBCM_Test::Hs_Tpms_ECU_Dynamic_States;
    Hs_Tpms_ECU_Static_States = @sysvar::NBCM_Test::Hs_Tpms_ECU_Static_States;
    Hs_Tpms_Network_Management_State = @sysvar::NBCM_Test::Hs_Tpms_Network_Management_State;
    Hs_Tpms_Tx_TimeOut_Counter = @sysvar::NBCM_Test::Hs_Tpms_Tx_TimeOut_Counter;
    Ls_Peps_System_Mode = @sysvar::NBCM_Test::Ls_Peps_System_Mode;
    Ls_Peps_Key_Active_Cmd_Info_Rke = @sysvar::NBCM_Test::Ls_Peps_Key_Active_Cmd_Info_Rke;
    Ls_Trunk_Unlock_PKE = @sysvar::NBCM_Test::Ls_Trunk_Unlock_PKE;
    Ls_Door_Unlock_PKE = @sysvar::NBCM_Test::Ls_Door_Unlock_PKE;
    Ls_Door_Lock_PKE = @sysvar::NBCM_Test::Ls_Door_Lock_PKE;
    Ls_Peps_SSB_Warning = @sysvar::NBCM_Test::Ls_Peps_SSB_Warning;
    Ls_Peps_Door_Open_Warning = @sysvar::NBCM_Test::Ls_Peps_Door_Open_Warning;
    Ls_Peps_FOB_LowBattery = @sysvar::NBCM_Test::Ls_Peps_FOB_LowBattery;
    Ls_Peps_Key_Out_Warning = @sysvar::NBCM_Test::Ls_Peps_Key_Out_Warning;
    Ls_Peps_ESCL_Warning = @sysvar::NBCM_Test::Ls_Peps_ESCL_Warning;
    Ls_Peps_Key_Fob_Authentication = @sysvar::NBCM_Test::Ls_Peps_Key_Fob_Authentication;
    Ls_Peps_KeyInside = @sysvar::NBCM_Test::Ls_Peps_KeyInside;
  }
  else
  {
    // restbus owns the signals -- publish them so the HTML panel can display
    @sysvar::NBCM_Test::Hs_Abs_Active = Hs_Abs_Active;
    @sysvar::NBCM_Test::Hs_Abs_DiagMode = Hs_Abs_DiagMode;
    @sysvar::NBCM_Test::Hs_Abs_Ebd_Active = Hs_Abs_Ebd_Active;
    @sysvar::NBCM_Test::Hs_Abs_Ebd_Error = Hs_Abs_Ebd_Error;
    @sysvar::NBCM_Test::Hs_Abs_Ebd_Warning = Hs_Abs_Ebd_Warning;
    @sysvar::NBCM_Test::Hs_Abs_Error = Hs_Abs_Error;
    @sysvar::NBCM_Test::Hs_Abs_Esp_Enable = Hs_Abs_Esp_Enable;
    @sysvar::NBCM_Test::Hs_Abs_Esp_Warning = Hs_Abs_Esp_Warning;
    @sysvar::NBCM_Test::Hs_Abs_Warning = Hs_Abs_Warning;
    @sysvar::NBCM_Test::Hs_Abs_Wheel_Speed_Fl = Hs_Abs_Wheel_Speed_Fl;
    @sysvar::NBCM_Test::Hs_Abs_Wheel_Speed_Fr = Hs_Abs_Wheel_Speed_Fr;
    @sysvar::NBCM_Test::Hs_Abs_Wheel_Speed_Rl = Hs_Abs_Wheel_Speed_Rl;
    @sysvar::NBCM_Test::Hs_Abs_Wheel_Speed_Rr = Hs_Abs_Wheel_Speed_Rr;
    @sysvar::NBCM_Test::Hs_Esc_GearShiftInhibit = Hs_Esc_GearShiftInhibit;
    @sysvar::NBCM_Test::Hs_Brake_Checksum = Hs_Brake_Checksum;
    @sysvar::NBCM_Test::Hs_Brake_RollCntr = Hs_Brake_RollCntr;
    @sysvar::NBCM_Test::Hs_Esc_EmergBrakeStatus = Hs_Esc_EmergBrakeStatus;
    @sysvar::NBCM_Test::Hs_Esc_EscDisableStatus = Hs_Esc_EscDisableStatus;
    @sysvar::NBCM_Test::Hs_Esc_EscError = Hs_Esc_EscError;
    @sysvar::NBCM_Test::Hs_Esc_HacActive = Hs_Esc_HacActive;
    @sysvar::NBCM_Test::Hs_Esc_HacError = Hs_Esc_HacError;
    @sysvar::NBCM_Test::Hs_Esc_LongAcceleration = Hs_Esc_LongAcceleration;
    @sysvar::NBCM_Test::Hs_Esc_LongAccelerationValid = Hs_Esc_LongAccelerationValid;
    @sysvar::NBCM_Test::Hs_Esc_TcsActive = Hs_Esc_TcsActive;
    @sysvar::NBCM_Test::Hs_Esc_TcsDisableStatus = Hs_Esc_TcsDisableStatus;
    @sysvar::NBCM_Test::Hs_Esc_TcsError = Hs_Esc_TcsError;
    @sysvar::NBCM_Test::Hs_Esc_TorqReductValid = Hs_Esc_TorqReductValid;
    @sysvar::NBCM_Test::Hs_Esc_TorqueReductType = Hs_Esc_TorqueReductType;
    @sysvar::NBCM_Test::Hs_Esc_TorqueReductValue = Hs_Esc_TorqueReductValue;
    @sysvar::NBCM_Test::Hs_Esp_Ctl = Hs_Esp_Ctl;
    @sysvar::NBCM_Test::Hs_AbsEsp_Sup_DiagMode = Hs_AbsEsp_Sup_DiagMode;
    @sysvar::NBCM_Test::Hs_Abs_Bus_Off_Counter = Hs_Abs_Bus_Off_Counter;
    @sysvar::NBCM_Test::Hs_Abs_Com_Loss = Hs_Abs_Com_Loss;
    @sysvar::NBCM_Test::Hs_Abs_Com_Loss_Counter = Hs_Abs_Com_Loss_Counter;
    @sysvar::NBCM_Test::Hs_Abs_Ecu_Dynamic_States = Hs_Abs_Ecu_Dynamic_States;
    @sysvar::NBCM_Test::Hs_Abs_Ecu_Static_States = Hs_Abs_Ecu_Static_States;
    @sysvar::NBCM_Test::Hs_Abs_Network_Management_State = Hs_Abs_Network_Management_State;
    @sysvar::NBCM_Test::Hs_Abs_Tx_TimeOut_Counter = Hs_Abs_Tx_TimeOut_Counter;
    @sysvar::NBCM_Test::Hs_Abs_VehicleSpeed = Hs_Abs_VehicleSpeed;
    @sysvar::NBCM_Test::Hs_Abs_VehicleSpeed_Invalid = Hs_Abs_VehicleSpeed_Invalid;
    @sysvar::NBCM_Test::Hs_Esc_Mcylinder_Pressure = Hs_Esc_Mcylinder_Pressure;
    @sysvar::NBCM_Test::Hs_Esc_Mcylinder_PressureInvalid = Hs_Esc_Mcylinder_PressureInvalid;
    @sysvar::NBCM_Test::Hs_Abs_Wheel_Pcnt_Fl = Hs_Abs_Wheel_Pcnt_Fl;
    @sysvar::NBCM_Test::Hs_Abs_Wheel_Pcnt_Fr = Hs_Abs_Wheel_Pcnt_Fr;
    @sysvar::NBCM_Test::Hs_Abs_Wheel_Pcnt_Rl = Hs_Abs_Wheel_Pcnt_Rl;
    @sysvar::NBCM_Test::Hs_Abs_Wheel_Pcnt_Rr = Hs_Abs_Wheel_Pcnt_Rr;
    @sysvar::NBCM_Test::Hs_Esc_iTpms_Reset_Progress = Hs_Esc_iTpms_Reset_Progress;
    @sysvar::NBCM_Test::Hs_Esc_iTpms_Status = Hs_Esc_iTpms_Status;
    @sysvar::NBCM_Test::Hs_Esc_PitchAngle = Hs_Esc_PitchAngle;
    @sysvar::NBCM_Test::Hs_Esc_RollAngle = Hs_Esc_RollAngle;
    @sysvar::NBCM_Test::Hs_Esc_YawRate = Hs_Esc_YawRate;
    @sysvar::NBCM_Test::Hs_Diag_Req_Broadcast = Hs_Diag_Req_Broadcast;
    @sysvar::NBCM_Test::Hs_Diag_Req_Icn_Data = Hs_Diag_Req_Icn_Data;
    @sysvar::NBCM_Test::Hs_Diag_Req_Mms_Data = Hs_Diag_Req_Mms_Data;
    @sysvar::NBCM_Test::Hs_Diag_Req_Nbcm_Data = Hs_Diag_Req_Nbcm_Data;
    @sysvar::NBCM_Test::Hs_Diag_Req_Rbg_Data = Hs_Diag_Req_Rbg_Data;
    @sysvar::NBCM_Test::Hs_Ems_Diagnostic_Answer = Hs_Ems_Diagnostic_Answer;
    @sysvar::NBCM_Test::Hs_Eps_Diagnostic_Answer = Hs_Eps_Diagnostic_Answer;
    @sysvar::NBCM_Test::Hs_Icu_Diagnostic_Answer = Hs_Icu_Diagnostic_Answer;
    @sysvar::NBCM_Test::Hs_Tcu_Diagnostic_Answer = Hs_Tcu_Diagnostic_Answer;
    @sysvar::NBCM_Test::Hs_Tpms_Diagnostic_Answer = Hs_Tpms_Diagnostic_Answer;
    @sysvar::NBCM_Test::Hs_Ems_BrakePedalStatus1 = Hs_Ems_BrakePedalStatus1;
    @sysvar::NBCM_Test::Hs_Ems_ClutchPedalStatus = Hs_Ems_ClutchPedalStatus;
    @sysvar::NBCM_Test::Hs_Ems_EngineActualTorque = Hs_Ems_EngineActualTorque;
    @sysvar::NBCM_Test::Hs_Ems_EngineFrictionTorque = Hs_Ems_EngineFrictionTorque;
    @sysvar::NBCM_Test::Hs_Ems_EngineThrottlePosition = Hs_Ems_EngineThrottlePosition;
    @sysvar::NBCM_Test::Hs_Ems_GearEngagedStatus = Hs_Ems_GearEngagedStatus;
    @sysvar::NBCM_Test::Hs_Ems_IndicatedEngineTorque1 = Hs_Ems_IndicatedEngineTorque1;
    @sysvar::NBCM_Test::Hs_Ems_MaxBrkTorq = Hs_Ems_MaxBrkTorq;
    @sysvar::NBCM_Test::Hs_Ems_Vaccumpump_Failure_Status = Hs_Ems_Vaccumpump_Failure_Status;
    @sysvar::NBCM_Test::Hs_Ems_VirtualAccPedal = Hs_Ems_VirtualAccPedal;
    @sysvar::NBCM_Test::Hs_Ems10_Checksum = Hs_Ems10_Checksum;
    @sysvar::NBCM_Test::Hs_Ems10_RollCntr = Hs_Ems10_RollCntr;
    @sysvar::NBCM_Test::Hs_Ems_AccPedalError = Hs_Ems_AccPedalError;
    @sysvar::NBCM_Test::Hs_Ems_AirConditionCommand2 = Hs_Ems_AirConditionCommand2;
    @sysvar::NBCM_Test::Hs_Ems_BrakePedalStatus2 = Hs_Ems_BrakePedalStatus2;
    @sysvar::NBCM_Test::Hs_Ems_Catalyst_Heating_Cycle = Hs_Ems_Catalyst_Heating_Cycle;
    @sysvar::NBCM_Test::Hs_Ems_DrivingCycle = Hs_Ems_DrivingCycle;
    @sysvar::NBCM_Test::Hs_Ems_EngineFuleCutOff = Hs_Ems_EngineFuleCutOff;
    @sysvar::NBCM_Test::Hs_Ems_EngineIntakeAirTemp = Hs_Ems_EngineIntakeAirTemp;
    @sysvar::NBCM_Test::Hs_Ems_F_EngTorqLoss = Hs_Ems_F_EngTorqLoss;
    @sysvar::NBCM_Test::Hs_Ems_N_altitudeFactor = Hs_Ems_N_altitudeFactor;
    @sysvar::NBCM_Test::Hs_Ems_ThrottleValvePosError = Hs_Ems_ThrottleValvePosError;
    @sysvar::NBCM_Test::Hs_Ems_TorqueFailure = Hs_Ems_TorqueFailure;
    @sysvar::NBCM_Test::Hs_Ems_WarmUpCycle = Hs_Ems_WarmUpCycle;
    @sysvar::NBCM_Test::Hs_Ems_ConditionIdle = Hs_Ems_ConditionIdle;
    @sysvar::NBCM_Test::Hs_Ems_CoolanTemperatureError = Hs_Ems_CoolanTemperatureError;
    @sysvar::NBCM_Test::Hs_Ems_DriverReqTorq = Hs_Ems_DriverReqTorq;
    @sysvar::NBCM_Test::Hs_Ems_EngBrkTorqwithoutTCU = Hs_Ems_EngBrkTorqwithoutTCU;
    @sysvar::NBCM_Test::Hs_Ems_EngineIdleSpeedAcitve = Hs_Ems_EngineIdleSpeedAcitve;
    @sysvar::NBCM_Test::Hs_Ems_EngineIdleTargetSpeed = Hs_Ems_EngineIdleTargetSpeed;
    @sysvar::NBCM_Test::Hs_Ems_EngineStatus = Hs_Ems_EngineStatus;
    @sysvar::NBCM_Test::Hs_Ems_MinlndicatedTorq = Hs_Ems_MinlndicatedTorq;
    @sysvar::NBCM_Test::HS_EMS_CRUISE_ON_OFF = HS_EMS_CRUISE_ON_OFF;
    @sysvar::NBCM_Test::Hs_Ems_Cruise_Active = Hs_Ems_Cruise_Active;
    @sysvar::NBCM_Test::Hs_Ems_Cruise_Setpoint = Hs_Ems_Cruise_Setpoint;
    @sysvar::NBCM_Test::Hs_Ems_Speed_Limit_Active = Hs_Ems_Speed_Limit_Active;
    @sysvar::NBCM_Test::Hs_Ems_Speed_limiterStatus = Hs_Ems_Speed_limiterStatus;
    @sysvar::NBCM_Test::Hs_Ems_Ac_Command = Hs_Ems_Ac_Command;
    @sysvar::NBCM_Test::Hs_Ems_Ac_Gasp_Sw1 = Hs_Ems_Ac_Gasp_Sw1;
    @sysvar::NBCM_Test::Hs_Ems_Ac_Gasp_Sw2 = Hs_Ems_Ac_Gasp_Sw2;
    @sysvar::NBCM_Test::Hs_Ems_Check_Engine = Hs_Ems_Check_Engine;
    @sysvar::NBCM_Test::Hs_Ems_EngineSpeedError = Hs_Ems_EngineSpeedError;
    @sysvar::NBCM_Test::Hs_Ems_EobdMil = Hs_Ems_EobdMil;
    @sysvar::NBCM_Test::Hs_Ems_GlowIndicationLamp = Hs_Ems_GlowIndicationLamp;
    @sysvar::NBCM_Test::Hs_Ems_Rpm = Hs_Ems_Rpm;
    @sysvar::NBCM_Test::Hs_Ems_Starter_Inhib = Hs_Ems_Starter_Inhib;
    @sysvar::NBCM_Test::Hs_Ems_Tco_Stop_Lamp = Hs_Ems_Tco_Stop_Lamp;
    @sysvar::NBCM_Test::Hs_Ems_Tco_Value = Hs_Ems_Tco_Value;
    @sysvar::NBCM_Test::Hs_Ems_WaterInFuelLamp = Hs_Ems_WaterInFuelLamp;
    @sysvar::NBCM_Test::Hs_Ems_Cng_Fault_Lamp = Hs_Ems_Cng_Fault_Lamp;
    @sysvar::NBCM_Test::Hs_Ems_Cng_Lamp = Hs_Ems_Cng_Lamp;
    @sysvar::NBCM_Test::Hs_Ems_Cng_Sensor_Err = Hs_Ems_Cng_Sensor_Err;
    @sysvar::NBCM_Test::Hs_Ems_Cng_Tank_Lvl_Out = Hs_Ems_Cng_Tank_Lvl_Out;
    @sysvar::NBCM_Test::Hs_Ems_Distance = Hs_Ems_Distance;
    @sysvar::NBCM_Test::Hs_Ems_Fuel_Tank_Level_Out = Hs_Ems_Fuel_Tank_Level_Out;
    @sysvar::NBCM_Test::Hs_Ems_Fuel_Tank_Sensor_Err = Hs_Ems_Fuel_Tank_Sensor_Err;
    @sysvar::NBCM_Test::Hs_Ems_Mono_Bi_Fuel_Ind = Hs_Ems_Mono_Bi_Fuel_Ind;
    @sysvar::NBCM_Test::Hs_Ems_Fuel_Cons = Hs_Ems_Fuel_Cons;
    @sysvar::NBCM_Test::Hs_Ems_Gear_Engaged_Ind = Hs_Ems_Gear_Engaged_Ind;
    @sysvar::NBCM_Test::Hs_Ems_Gsi_Gear_Info = Hs_Ems_Gsi_Gear_Info;
    @sysvar::NBCM_Test::Hs_Ems_Gsi_Gear_Value = Hs_Ems_Gsi_Gear_Value;
    @sysvar::NBCM_Test::Hs_Ems9_Checksum = Hs_Ems9_Checksum;
    @sysvar::NBCM_Test::Hs_Ems9_RollCntr = Hs_Ems9_RollCntr;
    @sysvar::NBCM_Test::Hs_Ems_ActualAccPedal = Hs_Ems_ActualAccPedal;
    @sysvar::NBCM_Test::Hs_Ems_BrakeEngineTorque2 = Hs_Ems_BrakeEngineTorque2;
    @sysvar::NBCM_Test::Hs_Ems_BrakeTorqueConstant = Hs_Ems_BrakeTorqueConstant;
    @sysvar::NBCM_Test::Hs_Ems_FrictionalTorq = Hs_Ems_FrictionalTorq;
    @sysvar::NBCM_Test::Hs_Ems_Chall_1 = Hs_Ems_Chall_1;
    @sysvar::NBCM_Test::Hs_Ems_Chall_2 = Hs_Ems_Chall_2;
    @sysvar::NBCM_Test::Hs_Ems_Diagnostic_Request = Hs_Ems_Diagnostic_Request;
    @sysvar::NBCM_Test::Hs_Ems_Icu_Dialog = Hs_Ems_Icu_Dialog;
    @sysvar::NBCM_Test::Hs_Ems_LearnPINResp = Hs_Ems_LearnPINResp;
    @sysvar::NBCM_Test::Hs_Ems_LearnSKResp = Hs_Ems_LearnSKResp;
    @sysvar::NBCM_Test::Hs_Ems_Reset_Resp = Hs_Ems_Reset_Resp;
    @sysvar::NBCM_Test::Hs_Ems_Bus_OFF_Counter = Hs_Ems_Bus_OFF_Counter;
    @sysvar::NBCM_Test::Hs_Ems_Com_Loss = Hs_Ems_Com_Loss;
    @sysvar::NBCM_Test::Hs_Ems_Com_Loss_Counter = Hs_Ems_Com_Loss_Counter;
    @sysvar::NBCM_Test::Hs_Ems_Diag_Mode = Hs_Ems_Diag_Mode;
    @sysvar::NBCM_Test::Hs_Ems_ECU_Dynamic_States = Hs_Ems_ECU_Dynamic_States;
    @sysvar::NBCM_Test::Hs_Ems_ECU_Static_States = Hs_Ems_ECU_Static_States;
    @sysvar::NBCM_Test::Hs_Ems_Network_Management_State = Hs_Ems_Network_Management_State;
    @sysvar::NBCM_Test::Hs_Ems_Tx_TimeOut_Counter = Hs_Ems_Tx_TimeOut_Counter;
    @sysvar::NBCM_Test::Hs_Ems_AmbientPressureInvalid = Hs_Ems_AmbientPressureInvalid;
    @sysvar::NBCM_Test::Hs_Ems_AmbintTemp = Hs_Ems_AmbintTemp;
    @sysvar::NBCM_Test::Hs_Ems_TeachSKResp = Hs_Ems_TeachSKResp;
    @sysvar::NBCM_Test::Hs_Epas_Warning = Hs_Epas_Warning;
    @sysvar::NBCM_Test::Hs_Eps_Diagnostic_Request = Hs_Eps_Diagnostic_Request;
    @sysvar::NBCM_Test::Hs_Eps_Bus_OFF_Counter = Hs_Eps_Bus_OFF_Counter;
    @sysvar::NBCM_Test::Hs_Eps_COM_Loss = Hs_Eps_COM_Loss;
    @sysvar::NBCM_Test::Hs_Eps_Com_Loss_Counter = Hs_Eps_Com_Loss_Counter;
    @sysvar::NBCM_Test::Hs_Eps_Diag_Mode = Hs_Eps_Diag_Mode;
    @sysvar::NBCM_Test::Hs_Eps_ECU_Dynamic_States = Hs_Eps_ECU_Dynamic_States;
    @sysvar::NBCM_Test::Hs_Eps_ECU_Static_States = Hs_Eps_ECU_Static_States;
    @sysvar::NBCM_Test::Hs_Eps_Network_Management_State = Hs_Eps_Network_Management_State;
    @sysvar::NBCM_Test::Hs_Eps_Tx_TimeOut_Counter = Hs_Eps_Tx_TimeOut_Counter;
    @sysvar::NBCM_Test::Hs_Sas_Angle = Hs_Sas_Angle;
    @sysvar::NBCM_Test::Hs_Sas_Message_Number = Hs_Sas_Message_Number;
    @sysvar::NBCM_Test::Hs_Sas_Speed = Hs_Sas_Speed;
    @sysvar::NBCM_Test::Hs_Sas_Value_check_message_bytes = Hs_Sas_Value_check_message_bytes;
    @sysvar::NBCM_Test::Hs_Sas_internal_status_flags = Hs_Sas_internal_status_flags;
    @sysvar::NBCM_Test::LS_HVAC_DIAG_RESP = LS_HVAC_DIAG_RESP;
    @sysvar::NBCM_Test::LS_HVAC_FAULT_ID = LS_HVAC_FAULT_ID;
    @sysvar::NBCM_Test::LS_HVAC_FAULT_STATUS = LS_HVAC_FAULT_STATUS;
    @sysvar::NBCM_Test::LS_HVAC_AC_SW = LS_HVAC_AC_SW;
    @sysvar::NBCM_Test::LS_HVAC_INDOOR_TEMP = LS_HVAC_INDOOR_TEMP;
    @sysvar::NBCM_Test::LS_HVAC_SHT_SW = LS_HVAC_SHT_SW;
    @sysvar::NBCM_Test::LS_HVAC_BUSOFF_COUNTER = LS_HVAC_BUSOFF_COUNTER;
    @sysvar::NBCM_Test::LS_HVAC_BUS_ERROR = LS_HVAC_BUS_ERROR;
    @sysvar::NBCM_Test::LS_HVAC_BUS_ERROR_COUNTER = LS_HVAC_BUS_ERROR_COUNTER;
    @sysvar::NBCM_Test::LS_HVAC_COM_LOSS = LS_HVAC_COM_LOSS;
    @sysvar::NBCM_Test::LS_HVAC_COM_LOSS_COUNTER = LS_HVAC_COM_LOSS_COUNTER;
    @sysvar::NBCM_Test::LS_HVAC_DIAG_MODE = LS_HVAC_DIAG_MODE;
    @sysvar::NBCM_Test::LS_HVAC_NBCM_DYN_ABSENT = LS_HVAC_NBCM_DYN_ABSENT;
    @sysvar::NBCM_Test::LS_HVAC_NBCM_STATIC_ABSENT = LS_HVAC_NBCM_STATIC_ABSENT;
    @sysvar::NBCM_Test::LS_HVAC_NM_STATE = LS_HVAC_NM_STATE;
    @sysvar::NBCM_Test::LS_HVAC_TX_TIMEOUT_COUNTER = LS_HVAC_TX_TIMEOUT_COUNTER;
    @sysvar::NBCM_Test::LS_ICN_DEBUG1 = LS_ICN_DEBUG1;
    @sysvar::NBCM_Test::LS_ICN_DEBUG2 = LS_ICN_DEBUG2;
    @sysvar::NBCM_Test::LS_ICN_DEBUG3 = LS_ICN_DEBUG3;
    @sysvar::NBCM_Test::LS_ICN_DEBUG4 = LS_ICN_DEBUG4;
    @sysvar::NBCM_Test::LS_ICN_DEBUG5 = LS_ICN_DEBUG5;
    @sysvar::NBCM_Test::LS_ICN_DEBUG6 = LS_ICN_DEBUG6;
    @sysvar::NBCM_Test::LS_ICN_DEBUG7 = LS_ICN_DEBUG7;
    @sysvar::NBCM_Test::LS_ICN_DEBUG8 = LS_ICN_DEBUG8;
    @sysvar::NBCM_Test::LS_ICN_BACKLIGHT = LS_ICN_BACKLIGHT;
    @sysvar::NBCM_Test::LS_ICN_DIAG_RESP = LS_ICN_DIAG_RESP;
    @sysvar::NBCM_Test::LS_ICN_FAULT_ID = LS_ICN_FAULT_ID;
    @sysvar::NBCM_Test::LS_ICN_FAULT_STATUS = LS_ICN_FAULT_STATUS;
    @sysvar::NBCM_Test::LS_ICN_AVS = LS_ICN_AVS;
    @sysvar::NBCM_Test::LS_ICN_MAINT_DIST = LS_ICN_MAINT_DIST;
    @sysvar::NBCM_Test::LS_ICN_CHANGE_AIRF = LS_ICN_CHANGE_AIRF;
    @sysvar::NBCM_Test::LS_ICN_CHANGE_OIL = LS_ICN_CHANGE_OIL;
    @sysvar::NBCM_Test::LS_ICN_CHANGE_OILF = LS_ICN_CHANGE_OILF;
    @sysvar::NBCM_Test::LS_ICN_ODO = LS_ICN_ODO;
    @sysvar::NBCM_Test::LS_ICN_BUSOFF_COUNTER = LS_ICN_BUSOFF_COUNTER;
    @sysvar::NBCM_Test::LS_ICN_BUS_ERROR = LS_ICN_BUS_ERROR;
    @sysvar::NBCM_Test::LS_ICN_BUS_ERROR_COUNTER = LS_ICN_BUS_ERROR_COUNTER;
    @sysvar::NBCM_Test::LS_ICN_COM_LOSS = LS_ICN_COM_LOSS;
    @sysvar::NBCM_Test::LS_ICN_COM_LOSS_COUNTER = LS_ICN_COM_LOSS_COUNTER;
    @sysvar::NBCM_Test::LS_ICN_DIAG_MODE = LS_ICN_DIAG_MODE;
    @sysvar::NBCM_Test::LS_ICN_NBCM_DYN_ABSENT = LS_ICN_NBCM_DYN_ABSENT;
    @sysvar::NBCM_Test::LS_ICN_NBCM_STATIC_ABSENT = LS_ICN_NBCM_STATIC_ABSENT;
    @sysvar::NBCM_Test::LS_ICN_NM_STATE = LS_ICN_NM_STATE;
    @sysvar::NBCM_Test::LS_ICN_TX_TIMEOUT_COUNTER = LS_ICN_TX_TIMEOUT_COUNTER;
    @sysvar::NBCM_Test::LS_ICN_DATE_DAY = LS_ICN_DATE_DAY;
    @sysvar::NBCM_Test::LS_ICN_DATE_MONTH = LS_ICN_DATE_MONTH;
    @sysvar::NBCM_Test::LS_ICN_DATE_YEAR = LS_ICN_DATE_YEAR;
    @sysvar::NBCM_Test::LS_ICN_TIME_HOURS = LS_ICN_TIME_HOURS;
    @sysvar::NBCM_Test::LS_ICN_TIME_MINUTES = LS_ICN_TIME_MINUTES;
    @sysvar::NBCM_Test::LS_ICN_TIME_SECONDS = LS_ICN_TIME_SECONDS;
    @sysvar::NBCM_Test::LS_ICN_DIAG_RESP = LS_ICN_DIAG_RESP;
    @sysvar::NBCM_Test::LS_ICN_FAULT_ID = LS_ICN_FAULT_ID;
    @sysvar::NBCM_Test::LS_ICN_FAULT_STATUS = LS_ICN_FAULT_STATUS;
    @sysvar::NBCM_Test::LS_ICN_OUT_TEMP = LS_ICN_OUT_TEMP;
    @sysvar::NBCM_Test::LS_ICN_BACKLIGHT = LS_ICN_BACKLIGHT;
    @sysvar::NBCM_Test::LS_ICN_LOW_FLW = LS_ICN_LOW_FLW;
    @sysvar::NBCM_Test::LS_ICN_ODO = LS_ICN_ODO;
    @sysvar::NBCM_Test::LS_ICN_SPD_GWY = LS_ICN_SPD_GWY;
    @sysvar::NBCM_Test::LS_ICN_BUSOFF_COUNTER = LS_ICN_BUSOFF_COUNTER;
    @sysvar::NBCM_Test::LS_ICN_BUS_ERROR = LS_ICN_BUS_ERROR;
    @sysvar::NBCM_Test::LS_ICN_BUS_ERROR_COUNTER = LS_ICN_BUS_ERROR_COUNTER;
    @sysvar::NBCM_Test::LS_ICN_COM_LOSS = LS_ICN_COM_LOSS;
    @sysvar::NBCM_Test::LS_ICN_COM_LOSS_COUNTER = LS_ICN_COM_LOSS_COUNTER;
    @sysvar::NBCM_Test::LS_ICN_DIAG_MODE = LS_ICN_DIAG_MODE;
    @sysvar::NBCM_Test::LS_ICN_NBCM_DYN_ABSENT = LS_ICN_NBCM_DYN_ABSENT;
    @sysvar::NBCM_Test::LS_ICN_NBCM_STATIC_ABSENT = LS_ICN_NBCM_STATIC_ABSENT;
    @sysvar::NBCM_Test::LS_ICN_NM_STATE = LS_ICN_NM_STATE;
    @sysvar::NBCM_Test::LS_ICN_TX_TIMEOUT_COUNTER = LS_ICN_TX_TIMEOUT_COUNTER;
    @sysvar::NBCM_Test::LS_ICN_VERSION_MAJOR = LS_ICN_VERSION_MAJOR;
    @sysvar::NBCM_Test::LS_ICN_VERSION_MINOR = LS_ICN_VERSION_MINOR;
    @sysvar::NBCM_Test::Ls_Icn_Abs_Ehb_FaultLamp = Ls_Icn_Abs_Ehb_FaultLamp;
    @sysvar::NBCM_Test::Ls_Icn_BattCharge_FaultLamp = Ls_Icn_BattCharge_FaultLamp;
    @sysvar::NBCM_Test::Ls_Icn_Brake_Fluid_AlarmLamp = Ls_Icn_Brake_Fluid_AlarmLamp;
    @sysvar::NBCM_Test::Ls_Icn_Door_Open_Lamp = Ls_Icn_Door_Open_Lamp;
    @sysvar::NBCM_Test::Ls_Icn_ElecBrkSplit_FaultLmp = Ls_Icn_ElecBrkSplit_FaultLmp;
    @sysvar::NBCM_Test::Ls_Icn_Elec_Genrt_Fault_Lamp = Ls_Icn_Elec_Genrt_Fault_Lamp;
    @sysvar::NBCM_Test::Ls_Icn_Esp_Asr_FaultLamp = Ls_Icn_Esp_Asr_FaultLamp;
    @sysvar::NBCM_Test::Ls_Icn_FootOnBrake_Lamp = Ls_Icn_FootOnBrake_Lamp;
    @sysvar::NBCM_Test::Ls_Icn_Low_Fuel_Lamp = Ls_Icn_Low_Fuel_Lamp;
    @sysvar::NBCM_Test::Ls_Icn_OilPressure_AlarmLamp = Ls_Icn_OilPressure_AlarmLamp;
    @sysvar::NBCM_Test::Ls_Icn_ParkingBrakeLamp = Ls_Icn_ParkingBrakeLamp;
    @sysvar::NBCM_Test::Ls_Icn_PasAirbagInhibLamp = Ls_Icn_PasAirbagInhibLamp;
    @sysvar::NBCM_Test::Ls_Icn_PassiveSafty_FaultLmp = Ls_Icn_PassiveSafty_FaultLmp;
    @sysvar::NBCM_Test::Ls_Icn_PowerSteeringFaultLamp = Ls_Icn_PowerSteeringFaultLamp;
    @sysvar::NBCM_Test::Ls_Icn_Service_Lamp = Ls_Icn_Service_Lamp;
    @sysvar::NBCM_Test::Ls_Icn_Stop_Lamp = Ls_Icn_Stop_Lamp;
    @sysvar::NBCM_Test::Ls_Icn_Tpms_AlarmLamp = Ls_Icn_Tpms_AlarmLamp;
    @sysvar::NBCM_Test::Ls_Icn_WaterTemp_AlarmLamp = Ls_Icn_WaterTemp_AlarmLamp;
    @sysvar::NBCM_Test::Ls_Icu_Key_Inside = Ls_Icu_Key_Inside;
    @sysvar::NBCM_Test::Ls_Icu_TP_Position = Ls_Icu_TP_Position;
    @sysvar::NBCM_Test::Ls_Icn_Mileage = Ls_Icn_Mileage;
    @sysvar::NBCM_Test::Ls_Icn_Mileage_Comp = Ls_Icn_Mileage_Comp;
    @sysvar::NBCM_Test::Ls_Icn_Uds_Resp = Ls_Icn_Uds_Resp;
    @sysvar::NBCM_Test::Ls_Icn_Abs_Unit1 = Ls_Icn_Abs_Unit1;
    @sysvar::NBCM_Test::Ls_Icn_Abs_Unit2 = Ls_Icn_Abs_Unit2;
    @sysvar::NBCM_Test::Ls_Icn_Abs_Unit3 = Ls_Icn_Abs_Unit3;
    @sysvar::NBCM_Test::Ls_Icn_Busoff_Cnt = Ls_Icn_Busoff_Cnt;
    @sysvar::NBCM_Test::Ls_Icn_Comloss_Cnt = Ls_Icn_Comloss_Cnt;
    @sysvar::NBCM_Test::Ls_Icn_Comloss_Fault = Ls_Icn_Comloss_Fault;
    @sysvar::NBCM_Test::Ls_Icn_Nas_Cnt = Ls_Icn_Nas_Cnt;
    @sysvar::NBCM_Test::Ls_Icn_Nerr = Ls_Icn_Nerr;
    @sysvar::NBCM_Test::Ls_Icn_Nerr_Cnt = Ls_Icn_Nerr_Cnt;
    @sysvar::NBCM_Test::Ls_Icn_Nm_St = Ls_Icn_Nm_St;
    @sysvar::NBCM_Test::Ls_Icn_Ecu_Num = Ls_Icn_Ecu_Num;
    @sysvar::NBCM_Test::Ls_Icn_Msg_Tab_Dig1 = Ls_Icn_Msg_Tab_Dig1;
    @sysvar::NBCM_Test::Ls_Icn_Msg_Tab_Dig2 = Ls_Icn_Msg_Tab_Dig2;
    @sysvar::NBCM_Test::Ls_Icn_Msg_Tab_Edition = Ls_Icn_Msg_Tab_Edition;
    @sysvar::NBCM_Test::Ls_Icn_Sw_Ident = Ls_Icn_Sw_Ident;
    @sysvar::NBCM_Test::Ls_Icn_Sw_Ver_Day = Ls_Icn_Sw_Ver_Day;
    @sysvar::NBCM_Test::Ls_Icn_Sw_Ver_Month = Ls_Icn_Sw_Ver_Month;
    @sysvar::NBCM_Test::Ls_Icn_Sw_Ver_Year = Ls_Icn_Sw_Ver_Year;
    @sysvar::NBCM_Test::Ls_Icn_Dist_Unit = Ls_Icn_Dist_Unit;
    @sysvar::NBCM_Test::Ls_Icn_Esp_Sw_Req = Ls_Icn_Esp_Sw_Req;
    @sysvar::NBCM_Test::Ls_Icn_Maint_Reset_Req = Ls_Icn_Maint_Reset_Req;
    @sysvar::NBCM_Test::Ls_Icn_Rbg_Fault_St = Ls_Icn_Rbg_Fault_St;
    @sysvar::NBCM_Test::Ls_Icn_Rbg_Inhib_St = Ls_Icn_Rbg_Inhib_St;
    @sysvar::NBCM_Test::Ls_Icn_Reset_Partial_Odo = Ls_Icn_Reset_Partial_Odo;
    @sysvar::NBCM_Test::Ls_Icn_Reset_Tot_Trip1 = Ls_Icn_Reset_Tot_Trip1;
    @sysvar::NBCM_Test::Ls_Icn_Speed_Display = Ls_Icn_Speed_Display;
    @sysvar::NBCM_Test::Ls_Icn_Dtc_Info = Ls_Icn_Dtc_Info;
    @sysvar::NBCM_Test::Ls_Icn_Frame_Index = Ls_Icn_Frame_Index;
    @sysvar::NBCM_Test::Ls_Icn_Frame_Nb = Ls_Icn_Frame_Nb;
    @sysvar::NBCM_Test::Hs_Icu_Diagnostic_Request = Hs_Icu_Diagnostic_Request;
    @sysvar::NBCM_Test::Hs_Icu_Ems_dialog = Hs_Icu_Ems_dialog;
    @sysvar::NBCM_Test::Hs_Icu_Ems_Status = Hs_Icu_Ems_Status;
    @sysvar::NBCM_Test::Hs_Icu_Immo_Hardware_Version = Hs_Icu_Immo_Hardware_Version;
    @sysvar::NBCM_Test::Hs_Icu_Immo_Lamp_Command = Hs_Icu_Immo_Lamp_Command;
    @sysvar::NBCM_Test::Hs_Icu_Immo_Output_Lamp_St = Hs_Icu_Immo_Output_Lamp_St;
    @sysvar::NBCM_Test::Hs_Icu_Immo_Production_Date = Hs_Icu_Immo_Production_Date;
    @sysvar::NBCM_Test::Hs_Icu_Immo_Software_Version = Hs_Icu_Immo_Software_Version;
    @sysvar::NBCM_Test::Hs_Icu_Key_Inside = Hs_Icu_Key_Inside;
    @sysvar::NBCM_Test::Hs_Icu_Tp_Position = Hs_Icu_Tp_Position;
    @sysvar::NBCM_Test::Hs_Icu_Reset_Req_1 = Hs_Icu_Reset_Req_1;
    @sysvar::NBCM_Test::Hs_Icu_Reset_Req_2 = Hs_Icu_Reset_Req_2;
    @sysvar::NBCM_Test::Hs_Icu_Bus_OFF_Counter = Hs_Icu_Bus_OFF_Counter;
    @sysvar::NBCM_Test::Hs_Icu_Com_Loss = Hs_Icu_Com_Loss;
    @sysvar::NBCM_Test::Hs_Icu_Com_Loss_Counter = Hs_Icu_Com_Loss_Counter;
    @sysvar::NBCM_Test::Hs_Icu_Diag_Mode = Hs_Icu_Diag_Mode;
    @sysvar::NBCM_Test::Hs_Icu_Ecu_Dynamic_States = Hs_Icu_Ecu_Dynamic_States;
    @sysvar::NBCM_Test::Hs_Icu_Ecu_Static_States = Hs_Icu_Ecu_Static_States;
    @sysvar::NBCM_Test::Hs_Icu_Net_Management_State = Hs_Icu_Net_Management_State;
    @sysvar::NBCM_Test::Hs_Icu_Tx_TimeOut_Counter = Hs_Icu_Tx_TimeOut_Counter;
    @sysvar::NBCM_Test::Hs_Imm_Auth_1 = Hs_Imm_Auth_1;
    @sysvar::NBCM_Test::Hs_Imm_Auth_2 = Hs_Imm_Auth_2;
    @sysvar::NBCM_Test::Hs_Imm_LearnSKReq_1 = Hs_Imm_LearnSKReq_1;
    @sysvar::NBCM_Test::Hs_Imm_LearnSKReq_2 = Hs_Imm_LearnSKReq_2;
    @sysvar::NBCM_Test::Hs_Imm_TeachPINReq_1 = Hs_Imm_TeachPINReq_1;
    @sysvar::NBCM_Test::Hs_Imm_TeachPINReq_2 = Hs_Imm_TeachPINReq_2;
    @sysvar::NBCM_Test::Hs_Imm_TeachSKReq = Hs_Imm_TeachSKReq;
    @sysvar::NBCM_Test::Hs_iTMPS_Fault_MMS = Hs_iTMPS_Fault_MMS;
    @sysvar::NBCM_Test::Hs_iTPMS_Check_Tire_Pressure = Hs_iTPMS_Check_Tire_Pressure;
    @sysvar::NBCM_Test::Hs_iTPMS_Fault_ICN = Hs_iTPMS_Fault_ICN;
    @sysvar::NBCM_Test::Hs_iTPMS_Reset_Condition_NO = Hs_iTPMS_Reset_Condition_NO;
    @sysvar::NBCM_Test::Hs_iTPMS_Tire_Pressure_Reg = Hs_iTPMS_Tire_Pressure_Reg;
    @sysvar::NBCM_Test::LS_MMS_DIAG_RESP = LS_MMS_DIAG_RESP;
    @sysvar::NBCM_Test::Ls_Mms_Icn_Set_Day = Ls_Mms_Icn_Set_Day;
    @sysvar::NBCM_Test::Ls_Mms_Icn_Set_Hour = Ls_Mms_Icn_Set_Hour;
    @sysvar::NBCM_Test::Ls_Mms_Icn_Set_Hour_Mode = Ls_Mms_Icn_Set_Hour_Mode;
    @sysvar::NBCM_Test::Ls_Mms_Icn_Set_Min = Ls_Mms_Icn_Set_Min;
    @sysvar::NBCM_Test::Ls_Mms_Icn_Set_Month = Ls_Mms_Icn_Set_Month;
    @sysvar::NBCM_Test::Ls_Mms_Icn_Set_Year = Ls_Mms_Icn_Set_Year;
    @sysvar::NBCM_Test::Ls_Mms_Amb_Bkl_Level = Ls_Mms_Amb_Bkl_Level;
    @sysvar::NBCM_Test::Ls_Mms_Bluetooth_Active = Ls_Mms_Bluetooth_Active;
    @sysvar::NBCM_Test::Ls_Mms_Config_Valid = Ls_Mms_Config_Valid;
    @sysvar::NBCM_Test::Ls_Mms_Drl_Active = Ls_Mms_Drl_Active;
    @sysvar::NBCM_Test::Ls_Mms_Esc_Active = Ls_Mms_Esc_Active;
    @sysvar::NBCM_Test::Ls_Mms_Pas_Func_Permanent = Ls_Mms_Pas_Func_Permanent;
    @sysvar::NBCM_Test::Ls_Mms_Pas_Func_Temporary = Ls_Mms_Pas_Func_Temporary;
    @sysvar::NBCM_Test::Ls_Mms_Recognize_Trip = Ls_Mms_Recognize_Trip;
    @sysvar::NBCM_Test::Ls_Mms_Request_Trip1_reset = Ls_Mms_Request_Trip1_reset;
    @sysvar::NBCM_Test::Ls_Mms_Request_Trip2_reset = Ls_Mms_Request_Trip2_reset;
    @sysvar::NBCM_Test::Ls_Mms_Road_Finder_Active = Ls_Mms_Road_Finder_Active;
    @sysvar::NBCM_Test::Ls_Mms_Road_Finder_Time = Ls_Mms_Road_Finder_Time;
    @sysvar::NBCM_Test::Ls_Mms_Tpms_Active_Req = Ls_Mms_Tpms_Active_Req;
    @sysvar::NBCM_Test::Ls_Mms_Dtc_Info = Ls_Mms_Dtc_Info;
    @sysvar::NBCM_Test::Ls_Mms_Frame_Index = Ls_Mms_Frame_Index;
    @sysvar::NBCM_Test::Ls_Mms_Frame_Nb = Ls_Mms_Frame_Nb;
    @sysvar::NBCM_Test::Ls_Mms_Uds_Resp = Ls_Mms_Uds_Resp;
    @sysvar::NBCM_Test::Ls_Mms_Abs_Unit1 = Ls_Mms_Abs_Unit1;
    @sysvar::NBCM_Test::Ls_Mms_Abs_Unit2 = Ls_Mms_Abs_Unit2;
    @sysvar::NBCM_Test::Ls_Mms_Abs_Unit3 = Ls_Mms_Abs_Unit3;
    @sysvar::NBCM_Test::Ls_Mms_Busoff_Cnt = Ls_Mms_Busoff_Cnt;
    @sysvar::NBCM_Test::Ls_Mms_Comloss_Cnt = Ls_Mms_Comloss_Cnt;
    @sysvar::NBCM_Test::Ls_Mms_Comloss_Fault = Ls_Mms_Comloss_Fault;
    @sysvar::NBCM_Test::Ls_Mms_Nas_Cnt = Ls_Mms_Nas_Cnt;
    @sysvar::NBCM_Test::Ls_Mms_Nerr = Ls_Mms_Nerr;
    @sysvar::NBCM_Test::Ls_Mms_Nerr_Cnt = Ls_Mms_Nerr_Cnt;
    @sysvar::NBCM_Test::Ls_Mms_Nm_St = Ls_Mms_Nm_St;
    @sysvar::NBCM_Test::Ls_Mms_Ecu_Num = Ls_Mms_Ecu_Num;
    @sysvar::NBCM_Test::Ls_Mms_Msg_Tab_Dig1 = Ls_Mms_Msg_Tab_Dig1;
    @sysvar::NBCM_Test::Ls_Mms_Msg_Tab_Dig2 = Ls_Mms_Msg_Tab_Dig2;
    @sysvar::NBCM_Test::Ls_Mms_Msg_Tab_Edition = Ls_Mms_Msg_Tab_Edition;
    @sysvar::NBCM_Test::Ls_Mms_Sw_Ident = Ls_Mms_Sw_Ident;
    @sysvar::NBCM_Test::Ls_Mms_Sw_Ver_Day = Ls_Mms_Sw_Ver_Day;
    @sysvar::NBCM_Test::Ls_Mms_Sw_Ver_Month = Ls_Mms_Sw_Ver_Month;
    @sysvar::NBCM_Test::Ls_Mms_Sw_Ver_Year = Ls_Mms_Sw_Ver_Year;
    @sysvar::NBCM_Test::LS_ICN_DATE_DAY = LS_ICN_DATE_DAY;
    @sysvar::NBCM_Test::LS_ICN_DATE_MONTH = LS_ICN_DATE_MONTH;
    @sysvar::NBCM_Test::LS_ICN_DATE_YEAR = LS_ICN_DATE_YEAR;
    @sysvar::NBCM_Test::LS_ICN_TIME_HOURS = LS_ICN_TIME_HOURS;
    @sysvar::NBCM_Test::LS_ICN_TIME_MINUTES = LS_ICN_TIME_MINUTES;
    @sysvar::NBCM_Test::LS_ICN_TIME_SECONDS = LS_ICN_TIME_SECONDS;
    @sysvar::NBCM_Test::Hs_Peps_AuthFailWarning = Hs_Peps_AuthFailWarning;
    @sysvar::NBCM_Test::Hs_Peps_AuthenticationSt = Hs_Peps_AuthenticationSt;
    @sysvar::NBCM_Test::Hs_Peps_BrakeSwitchSt = Hs_Peps_BrakeSwitchSt;
    @sysvar::NBCM_Test::Hs_Peps_ClutchSwitchSt = Hs_Peps_ClutchSwitchSt;
    @sysvar::NBCM_Test::Hs_Peps_DeactivationWarning = Hs_Peps_DeactivationWarning;
    @sysvar::NBCM_Test::Hs_Peps_DoorLockReq = Hs_Peps_DoorLockReq;
    @sysvar::NBCM_Test::Hs_Peps_DoorLockWarning = Hs_Peps_DoorLockWarning;
    @sysvar::NBCM_Test::Hs_Peps_DoorUnlockReq = Hs_Peps_DoorUnlockReq;
    @sysvar::NBCM_Test::Hs_Peps_DriverButtonSt = Hs_Peps_DriverButtonSt;
    @sysvar::NBCM_Test::Hs_Peps_ESCLLearntMode = Hs_Peps_ESCLLearntMode;
    @sysvar::NBCM_Test::Hs_Peps_ESCLLockEnPowerSupplySt = Hs_Peps_ESCLLockEnPowerSupplySt;
    @sysvar::NBCM_Test::Hs_Peps_ESCLMotorPowerSupplySt = Hs_Peps_ESCLMotorPowerSupplySt;
    @sysvar::NBCM_Test::Hs_Peps_ESCLUnlockSt = Hs_Peps_ESCLUnlockSt;
    @sysvar::NBCM_Test::Hs_Peps_ESCLWarning = Hs_Peps_ESCLWarning;
    @sysvar::NBCM_Test::Hs_Peps_FOB_ID = Hs_Peps_FOB_ID;
    @sysvar::NBCM_Test::Hs_Peps_FobBattLowWarning = Hs_Peps_FobBattLowWarning;
    @sysvar::NBCM_Test::Hs_Peps_KeyOutWarning = Hs_Peps_KeyOutWarning;
    @sysvar::NBCM_Test::Hs_Peps_LearntMode = Hs_Peps_LearntMode;
    @sysvar::NBCM_Test::Hs_Peps_OpIndicationWarning = Hs_Peps_OpIndicationWarning;
    @sysvar::NBCM_Test::Hs_Peps_PasserngerButtonSt = Hs_Peps_PasserngerButtonSt;
    @sysvar::NBCM_Test::Hs_Peps_SSBWarning = Hs_Peps_SSBWarning;
    @sysvar::NBCM_Test::Hs_Peps_SSB_SW1St = Hs_Peps_SSB_SW1St;
    @sysvar::NBCM_Test::Hs_Peps_SSB_SW2St = Hs_Peps_SSB_SW2St;
    @sysvar::NBCM_Test::Hs_Peps_SysPowMode = Hs_Peps_SysPowMode;
    @sysvar::NBCM_Test::Hs_Peps_TrunkReq = Hs_Peps_TrunkReq;
    @sysvar::NBCM_Test::Hs_Peps_VehSpd = Hs_Peps_VehSpd;
    @sysvar::NBCM_Test::Hs_Peps_VehSpdVD = Hs_Peps_VehSpdVD;
    @sysvar::NBCM_Test::Hs_Peps_VehSpdWarning = Hs_Peps_VehSpdWarning;
    @sysvar::NBCM_Test::Hs_Peps_keyComdInfo = Hs_Peps_keyComdInfo;
    @sysvar::NBCM_Test::Ls_Rbg_Crash_Info = Ls_Rbg_Crash_Info;
    @sysvar::NBCM_Test::Ls_Rbg_Dtc_Info = Ls_Rbg_Dtc_Info;
    @sysvar::NBCM_Test::Ls_Rbg_Frame_Index = Ls_Rbg_Frame_Index;
    @sysvar::NBCM_Test::Ls_Rbg_Frame_Nb = Ls_Rbg_Frame_Nb;
    @sysvar::NBCM_Test::Ls_Rbg_Checksum = Ls_Rbg_Checksum;
    @sysvar::NBCM_Test::Ls_Rbg_Fault = Ls_Rbg_Fault;
    @sysvar::NBCM_Test::Ls_Rbg_Pass_Inhib = Ls_Rbg_Pass_Inhib;
    @sysvar::NBCM_Test::Ls_Rbg_Process_Cnt = Ls_Rbg_Process_Cnt;
    @sysvar::NBCM_Test::Ls_Rbg_Uds_Resp = Ls_Rbg_Uds_Resp;
    @sysvar::NBCM_Test::Ls_Rbg_Abs_Unit1 = Ls_Rbg_Abs_Unit1;
    @sysvar::NBCM_Test::Ls_Rbg_Abs_Unit2 = Ls_Rbg_Abs_Unit2;
    @sysvar::NBCM_Test::Ls_Rbg_Abs_Unit3 = Ls_Rbg_Abs_Unit3;
    @sysvar::NBCM_Test::Ls_Rbg_Busoff_Cnt = Ls_Rbg_Busoff_Cnt;
    @sysvar::NBCM_Test::Ls_Rbg_Comloss_Cnt = Ls_Rbg_Comloss_Cnt;
    @sysvar::NBCM_Test::Ls_Rbg_Comloss_Fault = Ls_Rbg_Comloss_Fault;
    @sysvar::NBCM_Test::Ls_Rbg_Nas_Cnt = Ls_Rbg_Nas_Cnt;
    @sysvar::NBCM_Test::Ls_Rbg_Nerr = Ls_Rbg_Nerr;
    @sysvar::NBCM_Test::Ls_Rbg_Nerr_Cnt = Ls_Rbg_Nerr_Cnt;
    @sysvar::NBCM_Test::Ls_Rbg_Nm_St = Ls_Rbg_Nm_St;
    @sysvar::NBCM_Test::Ls_Rbg_Ecu_Num = Ls_Rbg_Ecu_Num;
    @sysvar::NBCM_Test::Ls_Rbg_Msg_Tab_Dig1 = Ls_Rbg_Msg_Tab_Dig1;
    @sysvar::NBCM_Test::Ls_Rbg_Msg_Tab_Dig2 = Ls_Rbg_Msg_Tab_Dig2;
    @sysvar::NBCM_Test::Ls_Rbg_Msg_Tab_Edition = Ls_Rbg_Msg_Tab_Edition;
    @sysvar::NBCM_Test::Ls_Rbg_Sw_Ident = Ls_Rbg_Sw_Ident;
    @sysvar::NBCM_Test::Ls_Rbg_Sw_Ver_Day = Ls_Rbg_Sw_Ver_Day;
    @sysvar::NBCM_Test::Ls_Rbg_Sw_Ver_Month = Ls_Rbg_Sw_Ver_Month;
    @sysvar::NBCM_Test::Ls_Rbg_Sw_Ver_Year = Ls_Rbg_Sw_Ver_Year;
    @sysvar::NBCM_Test::Hs_Tcu_Diagnostic_Request = Hs_Tcu_Diagnostic_Request;
    @sysvar::NBCM_Test::Hs_Tcu_ActualGearValid = Hs_Tcu_ActualGearValid;
    @sysvar::NBCM_Test::Hs_Tcu_Current_Gear = Hs_Tcu_Current_Gear;
    @sysvar::NBCM_Test::Hs_Tcu_DriverMode = Hs_Tcu_DriverMode;
    @sysvar::NBCM_Test::Hs_Tcu_EngBrkTorqReductValue = Hs_Tcu_EngBrkTorqReductValue;
    @sysvar::NBCM_Test::Hs_Tcu_Gear_Lever_Pos = Hs_Tcu_Gear_Lever_Pos;
    @sysvar::NBCM_Test::Hs_Tcu_Info_1_Checksum = Hs_Tcu_Info_1_Checksum;
    @sysvar::NBCM_Test::Hs_Tcu_Info_1_RollCntr = Hs_Tcu_Info_1_RollCntr;
    @sysvar::NBCM_Test::Hs_Tcu_Mil_Req_Mil_On = Hs_Tcu_Mil_Req_Mil_On;
    @sysvar::NBCM_Test::Hs_Tcu_N_EngBrkTorqLimitValue = Hs_Tcu_N_EngBrkTorqLimitValue;
    @sysvar::NBCM_Test::Hs_Tcu_ReverseControl = Hs_Tcu_ReverseControl;
    @sysvar::NBCM_Test::Hs_Tcu_ShiftInProgress = Hs_Tcu_ShiftInProgress;
    @sysvar::NBCM_Test::Hs_Tcu_TargetGear = Hs_Tcu_TargetGear;
    @sysvar::NBCM_Test::Hs_Tcu_TargetGearValid = Hs_Tcu_TargetGearValid;
    @sysvar::NBCM_Test::Hs_Tcu_TorqConvClutchStatus = Hs_Tcu_TorqConvClutchStatus;
    @sysvar::NBCM_Test::Hs_Tcu_TorqLimitationReq = Hs_Tcu_TorqLimitationReq;
    @sysvar::NBCM_Test::Hs_Tcu_TransmissionFailureStatus = Hs_Tcu_TransmissionFailureStatus;
    @sysvar::NBCM_Test::Hs_Tcu_TransmissionOilTemp = Hs_Tcu_TransmissionOilTemp;
    @sysvar::NBCM_Test::Hs_Tcu_CoolFanReq = Hs_Tcu_CoolFanReq;
    @sysvar::NBCM_Test::Hs_Tcu_EngBrkTorqIncreValue = Hs_Tcu_EngBrkTorqIncreValue;
    @sysvar::NBCM_Test::Hs_Tcu_Info_2_Checksum = Hs_Tcu_Info_2_Checksum;
    @sysvar::NBCM_Test::Hs_Tcu_Info_2_RollCntr = Hs_Tcu_Info_2_RollCntr;
    @sysvar::NBCM_Test::Hs_Tcu_ShiftPositionValid = Hs_Tcu_ShiftPositionValid;
    @sysvar::NBCM_Test::Hs_Tcu_TorqConvTurbineSpeed = Hs_Tcu_TorqConvTurbineSpeed;
    @sysvar::NBCM_Test::Hs_Tcu_TorqIncreReq = Hs_Tcu_TorqIncreReq;
    @sysvar::NBCM_Test::Hs_Tcu_TorqReductReq = Hs_Tcu_TorqReductReq;
    @sysvar::NBCM_Test::Hs_Tcu_CrankingEnable = Hs_Tcu_CrankingEnable;
    @sysvar::NBCM_Test::Hs_Tcu_DesiredEngIdlSpdReq = Hs_Tcu_DesiredEngIdlSpdReq;
    @sysvar::NBCM_Test::Hs_Tcu_DesiredEngIdlSpdReqActive = Hs_Tcu_DesiredEngIdlSpdReqActive;
    @sysvar::NBCM_Test::Hs_Tcu_IdleContLoadTorqInvalid = Hs_Tcu_IdleContLoadTorqInvalid;
    @sysvar::NBCM_Test::Hs_Tcu_IdleControlLoadTorque = Hs_Tcu_IdleControlLoadTorque;
    @sysvar::NBCM_Test::Hs_Tcu_LaunchVehicle = Hs_Tcu_LaunchVehicle;
    @sysvar::NBCM_Test::Hs_Tcu_MaxEngSpeedLimReq = Hs_Tcu_MaxEngSpeedLimReq;
    @sysvar::NBCM_Test::Hs_Tcu_OutputShaftSpeed = Hs_Tcu_OutputShaftSpeed;
    @sysvar::NBCM_Test::Hs_Tcu_OvertempLevel = Hs_Tcu_OvertempLevel;
    @sysvar::NBCM_Test::Hs_Tcu_Bus_OFF_Counter = Hs_Tcu_Bus_OFF_Counter;
    @sysvar::NBCM_Test::Hs_Tcu_Com_Loss = Hs_Tcu_Com_Loss;
    @sysvar::NBCM_Test::Hs_Tcu_Com_Loss_Counter = Hs_Tcu_Com_Loss_Counter;
    @sysvar::NBCM_Test::Hs_Tcu_Diag_Mode = Hs_Tcu_Diag_Mode;
    @sysvar::NBCM_Test::Hs_Tcu_Ecu_Dynamic_States = Hs_Tcu_Ecu_Dynamic_States;
    @sysvar::NBCM_Test::Hs_Tcu_Ecu_Static_States = Hs_Tcu_Ecu_Static_States;
    @sysvar::NBCM_Test::Hs_Tcu_Network_Management_State = Hs_Tcu_Network_Management_State;
    @sysvar::NBCM_Test::Hs_Tcu_Tx_TimeOut_Counter = Hs_Tcu_Tx_TimeOut_Counter;
    @sysvar::NBCM_Test::Hs_Tpms_Diagnostic_Request = Hs_Tpms_Diagnostic_Request;
    @sysvar::NBCM_Test::Hs_TpmsLearningSt = Hs_TpmsLearningSt;
    @sysvar::NBCM_Test::Hs_Tpms_SystemSt = Hs_Tpms_SystemSt;
    @sysvar::NBCM_Test::Hs_Tpms_TireBatteryPowerSt = Hs_Tpms_TireBatteryPowerSt;
    @sysvar::NBCM_Test::Hs_Tpms_TireId = Hs_Tpms_TireId;
    @sysvar::NBCM_Test::Hs_Tpms_TireInfoInvalid = Hs_Tpms_TireInfoInvalid;
    @sysvar::NBCM_Test::Hs_Tpms_TireLeakage = Hs_Tpms_TireLeakage;
    @sysvar::NBCM_Test::Hs_Tpms_TirePressure = Hs_Tpms_TirePressure;
    @sysvar::NBCM_Test::Hs_Tpms_TirePressureSt = Hs_Tpms_TirePressureSt;
    @sysvar::NBCM_Test::Hs_Tpms_TireTemperature = Hs_Tpms_TireTemperature;
    @sysvar::NBCM_Test::Hs_Tpms_TireTemperatureSt = Hs_Tpms_TireTemperatureSt;
    @sysvar::NBCM_Test::Hs_Tpms_Bus_OFF_Counter = Hs_Tpms_Bus_OFF_Counter;
    @sysvar::NBCM_Test::Hs_Tpms_COM_Loss = Hs_Tpms_COM_Loss;
    @sysvar::NBCM_Test::Hs_Tpms_Com_Loss_Counter = Hs_Tpms_Com_Loss_Counter;
    @sysvar::NBCM_Test::Hs_Tpms_Diag_Mode = Hs_Tpms_Diag_Mode;
    @sysvar::NBCM_Test::Hs_Tpms_ECU_Dynamic_States = Hs_Tpms_ECU_Dynamic_States;
    @sysvar::NBCM_Test::Hs_Tpms_ECU_Static_States = Hs_Tpms_ECU_Static_States;
    @sysvar::NBCM_Test::Hs_Tpms_Network_Management_State = Hs_Tpms_Network_Management_State;
    @sysvar::NBCM_Test::Hs_Tpms_Tx_TimeOut_Counter = Hs_Tpms_Tx_TimeOut_Counter;
    @sysvar::NBCM_Test::Ls_Peps_System_Mode = Ls_Peps_System_Mode;
    @sysvar::NBCM_Test::Ls_Peps_Key_Active_Cmd_Info_Rke = Ls_Peps_Key_Active_Cmd_Info_Rke;
    @sysvar::NBCM_Test::Ls_Trunk_Unlock_PKE = Ls_Trunk_Unlock_PKE;
    @sysvar::NBCM_Test::Ls_Door_Unlock_PKE = Ls_Door_Unlock_PKE;
    @sysvar::NBCM_Test::Ls_Door_Lock_PKE = Ls_Door_Lock_PKE;
    @sysvar::NBCM_Test::Ls_Peps_SSB_Warning = Ls_Peps_SSB_Warning;
    @sysvar::NBCM_Test::Ls_Peps_Door_Open_Warning = Ls_Peps_Door_Open_Warning;
    @sysvar::NBCM_Test::Ls_Peps_FOB_LowBattery = Ls_Peps_FOB_LowBattery;
    @sysvar::NBCM_Test::Ls_Peps_Key_Out_Warning = Ls_Peps_Key_Out_Warning;
    @sysvar::NBCM_Test::Ls_Peps_ESCL_Warning = Ls_Peps_ESCL_Warning;
    @sysvar::NBCM_Test::Ls_Peps_Key_Fob_Authentication = Ls_Peps_Key_Fob_Authentication;
    @sysvar::NBCM_Test::Ls_Peps_KeyInside = Ls_Peps_KeyInside;
  }

  // keep the panel mirror of the node switches in sync
  @sysvar::NBCM_Test::OFFLINE_ABS = OFFLINE_ABS;
  @sysvar::NBCM_Test::OFFLINE_DIAG = OFFLINE_DIAG;
  @sysvar::NBCM_Test::OFFLINE_EMS = OFFLINE_EMS;
  @sysvar::NBCM_Test::OFFLINE_EPS = OFFLINE_EPS;
  @sysvar::NBCM_Test::OFFLINE_HVAC = OFFLINE_HVAC;
  @sysvar::NBCM_Test::OFFLINE_ICN = OFFLINE_ICN;
  @sysvar::NBCM_Test::OFFLINE_ICU = OFFLINE_ICU;
  @sysvar::NBCM_Test::OFFLINE_ITPMS = OFFLINE_ITPMS;
  @sysvar::NBCM_Test::OFFLINE_MMS = OFFLINE_MMS;
  @sysvar::NBCM_Test::OFFLINE_PEPS = OFFLINE_PEPS;
  @sysvar::NBCM_Test::OFFLINE_RBG = OFFLINE_RBG;
  @sysvar::NBCM_Test::OFFLINE_TCU = OFFLINE_TCU;
  @sysvar::NBCM_Test::OFFLINE_TPMS = OFFLINE_TPMS;

  publishHealth();

  gTick++;
  @sysvar::NBCM_Test::HB_BRIDGE = 0;   // reserved
}

/*----------------------------------------------------------------------------
  Turn the last-seen timestamps into the two numbers the panel binds to:
      HB_<NODE>   1 while the node talked within the last 500 ms
      AGE_<NODE>  age in milliseconds (0 when it was never seen)
----------------------------------------------------------------------------*/
void publishHealth()
{
  dword now = timeNow();

  publishNode(now, gLastSeen_ABS, &@sysvar::NBCM_Test::HB_ABS, &@sysvar::NBCM_Test::AGE_ABS);
  publishNode(now, gLastSeen_DIAG, &@sysvar::NBCM_Test::HB_DIAG, &@sysvar::NBCM_Test::AGE_DIAG);
  publishNode(now, gLastSeen_EMS, &@sysvar::NBCM_Test::HB_EMS, &@sysvar::NBCM_Test::AGE_EMS);
  publishNode(now, gLastSeen_EPS, &@sysvar::NBCM_Test::HB_EPS, &@sysvar::NBCM_Test::AGE_EPS);
  publishNode(now, gLastSeen_HVAC, &@sysvar::NBCM_Test::HB_HVAC, &@sysvar::NBCM_Test::AGE_HVAC);
  publishNode(now, gLastSeen_ICN, &@sysvar::NBCM_Test::HB_ICN, &@sysvar::NBCM_Test::AGE_ICN);
  publishNode(now, gLastSeen_ICU, &@sysvar::NBCM_Test::HB_ICU, &@sysvar::NBCM_Test::AGE_ICU);
  publishNode(now, gLastSeen_ITPMS, &@sysvar::NBCM_Test::HB_ITPMS, &@sysvar::NBCM_Test::AGE_ITPMS);
  publishNode(now, gLastSeen_MMS, &@sysvar::NBCM_Test::HB_MMS, &@sysvar::NBCM_Test::AGE_MMS);
  publishNode(now, gLastSeen_PEPS, &@sysvar::NBCM_Test::HB_PEPS, &@sysvar::NBCM_Test::AGE_PEPS);
  publishNode(now, gLastSeen_RBG, &@sysvar::NBCM_Test::HB_RBG, &@sysvar::NBCM_Test::AGE_RBG);
  publishNode(now, gLastSeen_TCU, &@sysvar::NBCM_Test::HB_TCU, &@sysvar::NBCM_Test::AGE_TCU);
  publishNode(now, gLastSeen_TPMS, &@sysvar::NBCM_Test::HB_TPMS, &@sysvar::NBCM_Test::AGE_TPMS);
}

void publishNode(dword now, dword lastSeen, long *hb, long *age)
{
  long delta;

  if (lastSeen == 0)
  {
    *hb  = 0;
    *age = 0;
    return;
  }
  delta = (long)(now - lastSeen);
  *age = delta;
  *hb  = (delta < 500) ? 1 : 0;
}

/*----------------------------------------------------------------------------
  Convenience handlerse -- allow simple keyboard checks from CANoe itself.
----------------------------------------------------------------------------*/
on key 't'
{
  @sysvar::NBCM_Test::DRIVE_MODE = (@sysvar::NBCM_Test::DRIVE_MODE == 1) ? 0 : 1;
  write("[TesterBridge] DRIVE_MODE toggled");
}
